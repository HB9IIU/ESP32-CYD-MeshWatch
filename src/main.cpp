#include <Arduino.h>
#include <SPI.h>
#include <WiFi.h>
#include <DNSServer.h>
#include <WebServer.h>
#include <Preferences.h>
#include <LittleFS.h>
#include <esp_rom_crc.h>
#include <TFT_eSPI.h>
#include <lvgl.h>
#include <cstring>
#include <time.h>
#include <sys/time.h>
#include <math.h>
#include <errno.h>
#include <lwip/sockets.h>
#include "meshtastic_enums.h"

#ifndef MESHWATCH_VERSION
#define MESHWATCH_VERSION "dev"  // release builds set this from the git tag
#endif

extern "C" const lv_img_dsc_t splash_image;  // generated by tools/make_splash.py

namespace {
constexpr uint8_t displayRotation = 1;
constexpr uint16_t nativeScreenWidth = 240;
constexpr uint16_t nativeScreenHeight = 320;
constexpr uint16_t screenWidth = (displayRotation % 2 == 0) ? nativeScreenWidth : nativeScreenHeight;
constexpr uint16_t screenHeight = (displayRotation % 2 == 0) ? nativeScreenHeight : nativeScreenWidth;
constexpr uint16_t drawBufferLines = 18;

constexpr uint8_t touchClk = 25;
constexpr uint8_t touchMosi = 32;
constexpr uint8_t touchMiso = 39;
constexpr uint8_t touchCs = 33;
constexpr uint8_t touchIrq = 36;
constexpr uint32_t touchSpiFrequency = 2500000;

constexpr uint16_t touchRawMinX = 240;
constexpr uint16_t touchRawMaxX = 3800;
constexpr uint16_t touchRawMinY = 200;
constexpr uint16_t touchRawMaxY = 3700;
constexpr uint16_t touchPressureThreshold = 300;

constexpr char kApSsid[] = "MeshWatch-Setup";
constexpr uint16_t kRadioPort = 4403;
// Testing aid: ignore the saved radio address so every boot runs the discovery scan.
// Saved WiFi credentials are not affected.
constexpr bool kForceRadioDiscovery = false;
constexpr int32_t kRadioConnectTimeoutMs = 3000;
constexpr uint32_t kRadioRetryMs = 5000;
constexpr uint32_t kRadioRescanRetryMs = 30000;
constexpr uint8_t kRescanAfterFailures = 3;
constexpr uint8_t kScanBatchSize = 10;  // lwIP allows 16 sockets in total
constexpr uint32_t kScanBatchTimeoutMs = 500;
constexpr size_t kMaxApiFrameSize = 512;
constexpr uint32_t kHeartbeatIntervalMs = 60000;

constexpr char kTimeZone[] = "CET-1CEST,M3.5.0,M10.5.0/3";  // Europe/Zurich
constexpr char kNtpServer[] = "pool.ntp.org";
constexpr time_t kValidEpoch = 1700000000;

constexpr uint8_t kMaxMessages = 50;
constexpr uint16_t kStoredMessageSlots = 256;
constexpr uint32_t kHistoryWindowSeconds = 24 * 3600;
constexpr uint32_t kTimeSyncWaitMs = 5000;
constexpr uint32_t kStoredMessageMagic = 0x4D57314D;  // "MW1M"
constexpr char kMessageStorePath[] = "/messages.bin";
constexpr uint8_t kRecentPacketIds = 32;
constexpr uint8_t kMaxNodes = 96;
constexpr uint8_t kMaxChannels = 8;
constexpr uint32_t kBroadcastAddress = 0xFFFFFFFF;
constexpr uint32_t kPortTextMessage = 1;
constexpr uint32_t kPortNodeInfo = 4;
constexpr uint32_t kPortTelemetry = 67;
constexpr uint8_t kUnknownHops = 0xFF;
constexpr uint8_t kNodeColumns = 4;
constexpr uint32_t kNodeTableRefreshMs = 5000;

constexpr uint32_t kScreensaverIdleMs = 2 * 60 * 1000;
constexpr uint32_t kScreensaverWakeMs = 30 * 1000;  // full brightness after a new message
constexpr uint32_t kClockFrameMs = 66;              // ~15 fps for the sweeping second hand
constexpr uint8_t kBacklightFull = 255;
constexpr uint8_t kBacklightDimmed = 77;  // ~30 %
constexpr lv_coord_t kClockRadius = 119;  // full screen height
constexpr uint32_t kClockFace = 0x1B1F27;
constexpr uint32_t kClockRim = 0x3A4150;
constexpr uint32_t kClockInk = 0xEEF0F3;
constexpr uint32_t kClockSecond = 0xFEE715;

constexpr lv_coord_t kHeaderHeight = 26;
constexpr lv_coord_t kTabBarHeight = 30;
constexpr uint32_t kColorBackground = 0x0E1014;
constexpr uint32_t kColorPanel = 0x1B1F27;
constexpr uint32_t kColorAccent = 0xFEE715;
constexpr uint32_t kColorSender = 0x7DD3FC;
constexpr uint32_t kColorMuted = 0x8A93A6;
constexpr uint32_t kColorGood = 0x22C55E;
constexpr uint32_t kColorWarn = 0xF59E0B;
constexpr uint32_t kColorBad = 0xEF4444;

enum class LinkState { Setup, Searching, Connecting, Loading, Ready, Down, NotFound };
enum class Page { Messages, Nodes, Info };

// What the connected radio reports about itself; filled during the config download
// and refreshed by its own telemetry.
struct RadioInfo {
  char shortName[8];
  char firmware[24];
  bool hasUser;
  uint8_t hwModel;
  uint8_t role;
  bool hasRebootCount;
  uint32_t rebootCount;
  bool hasBattery;
  uint8_t battery;  // 101 = external power
  bool hasVoltage;
  float voltage;
  bool hasChannelUtil;
  float channelUtil;
  bool hasAirUtilTx;
  float airUtilTx;
  bool hasUptime;
  uint32_t uptimeSeconds;
  uint32_t metricsAt;  // millis() when the metrics arrived, 0 if never
  bool hasPosition;
  int32_t latitudeI;
  int32_t longitudeI;
  bool hasAltitude;
  int32_t altitude;
  bool hasLora;
  bool usePreset;
  uint8_t modemPreset;
  uint8_t region;
  uint8_t hopLimit;
  int32_t txPower;
};

// One slot of the on-flash message ring. Names are stored resolved, because after a
// reboot the node database is not loaded yet when the history is shown.
struct StoredMessage {
  uint32_t magic;
  uint32_t sequence;  // increases with every stored message; picks the newest slots
  uint32_t packetId;
  uint32_t timestamp;  // epoch seconds, 0 if unknown
  char sender[32];
  char channel[16];
  char text[200];
  uint32_t crc;  // over everything above
};

struct NodeEntry {
  uint32_t number;
  char name[32];
  uint32_t lastHeard;  // epoch seconds, 0 if unknown
  float snr;
  uint8_t hopsAway;    // kUnknownHops if unknown
  uint8_t battery;     // 1-100 %, 101 = external power, 0 if unknown
  bool viaMqtt;
};

TFT_eSPI tft = TFT_eSPI(nativeScreenWidth, nativeScreenHeight);
SPIClass touchSpi(VSPI);
DNSServer dnsServer;
WebServer webServer(80);
Preferences preferences;
WiFiClient radioClient;
lv_disp_draw_buf_t drawBuffer;
lv_color_t buffer1[screenWidth * drawBufferLines];
lv_color_t buffer2[screenWidth * drawBufferLines];

lv_obj_t *monitorScreen = nullptr;
lv_obj_t *splashStatusLabel = nullptr;
lv_style_t cardStyle;
lv_style_t unreadStyle;
lv_obj_t *clockLabel = nullptr;
lv_obj_t *statusDot = nullptr;
lv_obj_t *newBadge = nullptr;
lv_obj_t *messageList = nullptr;
lv_obj_t *emptyLabel = nullptr;
lv_obj_t *footerLabel = nullptr;
lv_obj_t *nodeTable = nullptr;
lv_obj_t *messagesTab = nullptr;
lv_obj_t *nodesTab = nullptr;
lv_obj_t *nodesTabLabel = nullptr;
lv_obj_t *infoTable = nullptr;
lv_obj_t *infoTab = nullptr;
RadioInfo radioInfo{};
bool channelEnabled[kMaxChannels] = {};
uint16_t storedMessageCount = 0;
Page activePage = Page::Messages;
bool nodeTableDirty = true;
uint32_t lastNodeTableRefresh = 0;

NodeEntry nodes[kMaxNodes] = {};
uint8_t nodeCount = 0;
uint8_t nextNodeSlot = 0;
char channelNames[kMaxChannels][16] = {};
uint16_t unreadCount = 0;
bool messageStoreReady = false;
uint16_t nextStoreSlot = 0;
uint32_t nextStoreSequence = 1;
uint32_t recentPacketIds[kRecentPacketIds] = {};
uint8_t recentPacketIdIndex = 0;
uint32_t packetCount = 0;
uint32_t lastPacketAt = 0;

LinkState linkState = LinkState::Connecting;
uint32_t localNodeNumber = 0;
uint32_t lastRadioConnectAttempt = 0;
uint32_t lastHeartbeatAt = 0;
bool hasRadioConnectAttempted = false;
IPAddress radioAddress;
bool hasRadioAddress = false;
uint8_t failedConnects = 0;
uint32_t radioRetryMs = kRadioRetryMs;
bool radioApiConnected = false;
uint8_t apiHeader[4] = {};
uint8_t apiHeaderLength = 0;
uint8_t apiFrame[kMaxApiFrameSize] = {};
uint16_t apiExpectedLength = 0;
uint16_t apiReceivedLength = 0;

void refreshStatus();
void onScreensaverMessage(bool unread);

// Updates the status line on the boot splash; a no-op once the splash is gone.
void setSplashStatus(const char *text) {
  if (splashStatusLabel == nullptr) {
    return;
  }
  lv_label_set_text(splashStatusLabel, text);
  lv_refr_now(nullptr);
}

void setLinkState(LinkState state) {
  linkState = state;
  refreshStatus();
}

bool saveWifiCredentials(const String &ssid, const String &password) {
  preferences.begin("wifi_cfg", false);
  const bool ok = preferences.putString("ssid", ssid) && preferences.putString("password", password);
  preferences.end();
  return ok;
}

bool loadWifiCredentials(String &ssid, String &password) {
  preferences.begin("wifi_cfg", false);  // read-only would log an error while nothing is saved yet
  const bool hasSsid = preferences.isKey("ssid");
  const bool hasPassword = preferences.isKey("password");
  if (hasSsid && hasPassword) {
    ssid = preferences.getString("ssid");
    password = preferences.getString("password");
    preferences.end();
    return !ssid.isEmpty() && !password.isEmpty();
  }
  preferences.end();
  return false;
}

bool connectToStoredWifi() {
  String ssid;
  String password;
  if (!loadWifiCredentials(ssid, password)) {
    return false;
  }

  Serial.printf("Connecting to saved WiFi SSID: %s\n", ssid.c_str());
  char splashText[64];
  snprintf(splashText, sizeof(splashText), "Connecting to WiFi %s...", ssid.c_str());
  setSplashStatus(splashText);
  WiFi.mode(WIFI_STA);
  WiFi.begin(ssid.c_str(), password.c_str());

  uint32_t start = millis();
  while (WiFi.status() != WL_CONNECTED && millis() - start < 15000) {
    delay(250);
    Serial.print('.');
  }

  if (WiFi.status() == WL_CONNECTED) {
    Serial.println();
    Serial.print("WiFi connected. IP: ");
    Serial.println(WiFi.localIP());
    configTzTime(kTimeZone, kNtpServer);
    return true;
  }

  WiFi.disconnect(true);
  return false;
}

String captivePortalPage() {
  return R"HTML(
    <!DOCTYPE html>
    <html>
    <head>
      <meta charset="UTF-8">
      <meta name="viewport" content="width=device-width, initial-scale=1.0">
      <title>MeshWatch WiFi Setup</title>
      <style>
        body { font-family: Arial, sans-serif; background: #111827; color: #f3f4f6; margin: 0; padding: 24px; }
        .card { max-width: 420px; margin: 60px auto; padding: 24px; background: #1f2937; border-radius: 16px; box-shadow: 0 8px 24px rgba(0,0,0,0.35); }
        h1 { margin-top: 0; font-size: 26px; }
        label { display: block; margin: 16px 0 8px; font-weight: bold; }
        input { width: 100%; box-sizing: border-box; padding: 12px; border-radius: 10px; border: 1px solid #374151; background: #0f172a; color: white; font-size: 16px; }
        button { margin-top: 20px; width: 100%; padding: 12px; border: none; border-radius: 10px; background: #22c55e; color: #06250f; font-size: 16px; font-weight: bold; cursor: pointer; }
      </style>
    </head>
    <body>
      <div class="card">
        <h1>MeshWatch Setup</h1>
        <p>Connect this device to your WiFi network.</p>
        <form method="POST" action="/connect">
          <label for="ssid">WiFi SSID</label>
          <input id="ssid" name="ssid" type="text" placeholder="Your WiFi name" required>

          <label for="password">Password</label>
          <input id="password" name="password" type="password" placeholder="Your WiFi password" required>

          <button type="submit">Save & Connect</button>
        </form>
      </div>
    </body>
    </html>
  )HTML";
}

void handleRoot() {
  webServer.send(200, "text/html", captivePortalPage());
}

void handleConnect() {
  String ssid = webServer.arg("ssid");
  String password = webServer.arg("password");

  if (ssid.isEmpty()) {
    webServer.send(400, "text/plain", "Missing SSID");
    return;
  }

  if (saveWifiCredentials(ssid, password)) {
    webServer.send(200, "text/html", "<html><body><h1>Saved</h1><p>Connecting to WiFi...</p></body></html>");
    delay(1000);
    ESP.restart();
  } else {
    webServer.send(500, "text/plain", "Failed to save WiFi settings");
  }
}

void handleNotFound() {
  webServer.sendHeader("Location", "/", true);
  webServer.send(302, "text/plain", "");
}

// Setup panel at the top of the message list: a QR code that joins the open setup
// network (standard WIFI: format), with the manual steps next to it.
void showSetupQrCode() {
  if (emptyLabel != nullptr) {
    lv_obj_del(emptyLabel);
    emptyLabel = nullptr;
  }

  lv_obj_t *panel = lv_obj_create(messageList);
  lv_obj_remove_style_all(panel);
  lv_obj_set_size(panel, lv_pct(100), 172);
  lv_obj_clear_flag(panel, LV_OBJ_FLAG_CLICKABLE | LV_OBJ_FLAG_SCROLLABLE);
  lv_obj_move_to_index(panel, 0);

  char payload[64];
  snprintf(payload, sizeof(payload), "WIFI:T:nopass;S:%s;;", kApSsid);
  lv_obj_t *qrCode = lv_qrcode_create(panel, 150, lv_color_black(), lv_color_white());
  lv_qrcode_update(qrCode, payload, strlen(payload));
  lv_obj_set_style_border_color(qrCode, lv_color_white(), LV_PART_MAIN);
  lv_obj_set_style_border_width(qrCode, 8, LV_PART_MAIN);  // quiet zone for scanners
  lv_obj_align(qrCode, LV_ALIGN_LEFT_MID, 8, 0);

  lv_obj_t *title = lv_label_create(panel);
  lv_label_set_text(title, "WiFi setup");
  lv_obj_set_style_text_color(title, lv_color_hex(kColorAccent), LV_PART_MAIN);
  lv_obj_set_pos(title, 184, 14);

  lv_obj_t *steps = lv_label_create(panel);
  lv_label_set_long_mode(steps, LV_LABEL_LONG_WRAP);
  lv_obj_set_width(steps, 122);
  lv_obj_set_style_text_font(steps, &lv_font_montserrat_12, LV_PART_MAIN);
  lv_obj_set_style_text_color(steps, lv_color_white(), LV_PART_MAIN);
  lv_label_set_text_fmt(steps, "Scan with your phone to join %s.\n\nThe setup page opens by itself, or open 192.168.4.1",
                        kApSsid);
  lv_obj_set_pos(steps, 184, 38);
}

void startCaptivePortal() {
  WiFi.mode(WIFI_AP);
  WiFi.softAPConfig(IPAddress(192, 168, 4, 1), IPAddress(192, 168, 4, 1), IPAddress(255, 255, 255, 0));
  WiFi.softAP(kApSsid);

  dnsServer.start(53, "*", IPAddress(192, 168, 4, 1));
  webServer.on("/", HTTP_GET, handleRoot);
  webServer.on("/connect", HTTP_POST, handleConnect);
  webServer.onNotFound(handleNotFound);
  webServer.begin();

  Serial.println("Captive portal started");
  Serial.printf("AP SSID: %s\n", kApSsid);
  Serial.printf("AP IP: %s\n", WiFi.softAPIP().toString().c_str());
  showSetupQrCode();
  setLinkState(LinkState::Setup);
}

bool readProtoVarint(const uint8_t *data, size_t length, size_t &offset, uint64_t &value) {
  value = 0;
  for (uint8_t shift = 0; shift < 64; shift += 7) {
    if (offset >= length) {
      return false;
    }
    const uint8_t byte = data[offset++];
    value |= static_cast<uint64_t>(byte & 0x7F) << shift;
    if ((byte & 0x80) == 0) {
      return true;
    }
  }
  return false;
}

struct ProtoField {
  uint32_t number;
  uint8_t wireType;
  uint64_t integer;
  uint32_t fixed32;
  const uint8_t *bytes;
  size_t length;
};

bool readProtoField(const uint8_t *data, size_t length, size_t &offset, ProtoField &field) {
  uint64_t key = 0;
  if (!readProtoVarint(data, length, offset, key) || key == 0) {
    return false;
  }

  field.number = static_cast<uint32_t>(key >> 3);
  field.wireType = static_cast<uint8_t>(key & 0x07);
  field.integer = 0;
  field.fixed32 = 0;
  field.bytes = nullptr;
  field.length = 0;

  if (field.wireType == 0) {
    return readProtoVarint(data, length, offset, field.integer);
  }
  if (field.wireType == 1) {
    if (length - offset < 8) {
      return false;
    }
    offset += 8;
    return true;
  }
  if (field.wireType == 2) {
    uint64_t fieldLength = 0;
    if (!readProtoVarint(data, length, offset, fieldLength) || fieldLength > length - offset) {
      return false;
    }
    field.bytes = data + offset;
    field.length = static_cast<size_t>(fieldLength);
    offset += field.length;
    return true;
  }
  if (field.wireType == 5) {
    if (length - offset < 4) {
      return false;
    }
    field.fixed32 = static_cast<uint32_t>(data[offset]) |
                    (static_cast<uint32_t>(data[offset + 1]) << 8) |
                    (static_cast<uint32_t>(data[offset + 2]) << 16) |
                    (static_cast<uint32_t>(data[offset + 3]) << 24);
    offset += 4;
    return true;
  }
  return false;
}

// Maps a Unicode code point to something the built-in ASCII fonts can draw.
// Returns ' ' for whitespace and 0 for characters that should be dropped (emoji etc.).
char foldCodePoint(uint32_t codePoint) {
  static const char kLatin1Base[] = "AAAAAAACEEEEIIIIDNOOOOOxOUUUUYTsaaaaaaaceeeeiiiidnooooo/ouuuuyty";
  if (codePoint == '\t' || codePoint == '\n' || codePoint == '\r' || codePoint == 0xA0) {
    return ' ';
  }
  if (codePoint >= 0x20 && codePoint <= 0x7E) {
    return static_cast<char>(codePoint);
  }
  if (codePoint >= 0xC0 && codePoint <= 0xFF) {
    return kLatin1Base[codePoint - 0xC0];
  }
  switch (codePoint) {
    case 0x2018:
    case 0x2019:
      return '\'';
    case 0x201C:
    case 0x201D:
      return '"';
    case 0x2013:
    case 0x2014:
      return '-';
    default:
      return 0;
  }
}

// Decodes UTF-8 into drawable ASCII: accents are stripped, emoji dropped,
// and whitespace runs collapsed and trimmed.
void foldToAscii(const uint8_t *source, size_t length, char *destination, size_t destinationSize) {
  if (destination == nullptr || destinationSize == 0) {
    return;
  }

  size_t outIndex = 0;
  size_t index = 0;
  bool pendingSpace = false;
  while (source != nullptr && index < length && outIndex + 1 < destinationSize) {
    const uint8_t lead = source[index];
    uint32_t codePoint = 0;
    size_t sequenceLength = 1;
    if (lead < 0x80) {
      codePoint = lead;
    } else if ((lead & 0xE0) == 0xC0) {
      codePoint = lead & 0x1F;
      sequenceLength = 2;
    } else if ((lead & 0xF0) == 0xE0) {
      codePoint = lead & 0x0F;
      sequenceLength = 3;
    } else if ((lead & 0xF8) == 0xF0) {
      codePoint = lead & 0x07;
      sequenceLength = 4;
    } else {
      ++index;
      continue;
    }
    if (index + sequenceLength > length) {
      break;
    }

    bool valid = true;
    for (size_t extra = 1; extra < sequenceLength; ++extra) {
      const uint8_t continuation = source[index + extra];
      if ((continuation & 0xC0) != 0x80) {
        valid = false;
        break;
      }
      codePoint = (codePoint << 6) | (continuation & 0x3F);
    }
    index += valid ? sequenceLength : 1;
    if (!valid) {
      continue;
    }

    const char mapped = foldCodePoint(codePoint);
    if (mapped == ' ') {
      pendingSpace = outIndex > 0;
      continue;
    }
    if (mapped == 0) {
      continue;
    }
    if (pendingSpace) {
      if (outIndex + 2 >= destinationSize) {
        break;
      }
      destination[outIndex++] = ' ';
      pendingSpace = false;
    }
    destination[outIndex++] = mapped;
  }
  destination[outIndex] = '\0';
}

NodeEntry *findNode(uint32_t nodeNumber) {
  for (uint8_t index = 0; index < nodeCount; ++index) {
    if (nodes[index].number == nodeNumber) {
      return &nodes[index];
    }
  }
  return nullptr;
}

NodeEntry *findOrAddNode(uint32_t nodeNumber) {
  if (nodeNumber == 0) {
    return nullptr;
  }

  NodeEntry *entry = findNode(nodeNumber);
  if (entry == nullptr) {
    if (nodeCount < kMaxNodes) {
      entry = &nodes[nodeCount++];
    } else {
      entry = &nodes[nextNodeSlot];
      nextNodeSlot = (nextNodeSlot + 1) % kMaxNodes;
    }
    *entry = NodeEntry{};
    entry->number = nodeNumber;
    entry->hopsAway = kUnknownHops;
  }
  nodeTableDirty = true;
  return entry;
}

void rememberNodeName(uint32_t nodeNumber, const char *name) {
  NodeEntry *entry = findOrAddNode(nodeNumber);
  if (entry != nullptr && name != nullptr && name[0] != '\0') {
    snprintf(entry->name, sizeof(entry->name), "%s", name);
  }
}

float fixed32ToFloat(uint32_t bits) {
  float value = 0;
  memcpy(&value, &bits, sizeof(value));
  return value;
}

void nodeDisplayName(uint32_t nodeNumber, char *destination, size_t destinationSize) {
  const NodeEntry *entry = findNode(nodeNumber);
  if (entry != nullptr && entry->name[0] != '\0') {
    snprintf(destination, destinationSize, "%s", entry->name);
  } else {
    snprintf(destination, destinationSize, "!%08lx", static_cast<unsigned long>(nodeNumber));
  }
}

const char *enumName(const char *const *names, size_t count, uint32_t value) {
  return value < count && names[value][0] != '\0' ? names[value] : nullptr;
}

// LONG_FAST -> LongFast, as the Meshtastic apps display presets.
void presetDisplayName(uint8_t preset, char *destination, size_t destinationSize) {
  const char *name = enumName(kModemPresetNames, sizeof(kModemPresetNames) / sizeof(kModemPresetNames[0]), preset);
  if (name == nullptr) {
    snprintf(destination, destinationSize, "Preset %u", preset);
    return;
  }
  size_t outIndex = 0;
  bool upper = true;
  for (size_t index = 0; name[index] != '\0' && outIndex + 1 < destinationSize; ++index) {
    if (name[index] == '_') {
      upper = true;
      continue;
    }
    destination[outIndex++] = upper ? name[index] : static_cast<char>(tolower(name[index]));
    upper = false;
  }
  destination[outIndex] = '\0';
}

void channelDisplayName(uint32_t channel, uint32_t to, char *destination, size_t destinationSize) {
  if (to != kBroadcastAddress && to == localNodeNumber) {
    snprintf(destination, destinationSize, "DM");
  } else if (channel < kMaxChannels && channelNames[channel][0] != '\0') {
    snprintf(destination, destinationSize, "%s", channelNames[channel]);
  } else if (channel == 0 && radioInfo.hasLora && radioInfo.usePreset) {
    presetDisplayName(radioInfo.modemPreset, destination, destinationSize);
  } else if (channel == 0) {
    snprintf(destination, destinationSize, "Primary");
  } else {
    snprintf(destination, destinationSize, "Ch %lu", static_cast<unsigned long>(channel));
  }
}

void formatClock(time_t timestamp, char *destination, size_t destinationSize) {
  if (timestamp < kValidEpoch) {
    snprintf(destination, destinationSize, "--:--");
    return;
  }
  struct tm local {};
  localtime_r(&timestamp, &local);
  strftime(destination, destinationSize, "%H:%M", &local);
}

void formatAge(uint32_t elapsedMs, char *destination, size_t destinationSize) {
  const uint32_t seconds = elapsedMs / 1000;
  if (seconds < 60) {
    snprintf(destination, destinationSize, "%lus ago", static_cast<unsigned long>(seconds));
  } else if (seconds < 3600) {
    snprintf(destination, destinationSize, "%lum ago", static_cast<unsigned long>(seconds / 60));
  } else {
    snprintf(destination, destinationSize, "%luh ago", static_cast<unsigned long>(seconds / 3600));
  }
}

void refreshStatus() {
  if (footerLabel == nullptr || statusDot == nullptr) {
    return;
  }

  char text[48];
  uint32_t dotColor = kColorWarn;
  switch (linkState) {
    case LinkState::Setup:
      snprintf(text, sizeof(text), "WiFi setup");
      dotColor = kColorBad;
      break;
    case LinkState::Searching:
      snprintf(text, sizeof(text), "Searching...");
      break;
    case LinkState::Connecting:
      snprintf(text, sizeof(text), "Connecting...");
      break;
    case LinkState::NotFound:
      snprintf(text, sizeof(text), "No radio");
      dotColor = kColorBad;
      break;
    case LinkState::Loading:
      snprintf(text, sizeof(text), "Loading %u", nodeCount);
      break;
    case LinkState::Down:
      snprintf(text, sizeof(text), "Radio down");
      dotColor = kColorBad;
      break;
    case LinkState::Ready: {
      if (packetCount > 0) {
        formatAge(millis() - lastPacketAt, text, sizeof(text));
      } else {
        snprintf(text, sizeof(text), "Ready");
      }
      dotColor = kColorGood;
      break;
    }
  }
  lv_label_set_text(footerLabel, text);
  lv_obj_set_style_bg_color(statusDot, lv_color_hex(dotColor), LV_PART_MAIN);
  const uint8_t remoteNodes = nodeCount - (findNode(localNodeNumber) != nullptr ? 1 : 0);
  lv_label_set_text_fmt(nodesTabLabel, "Nodes %u", remoteNodes);
}

void refreshScreensaverBadge();

void refreshUnreadBadge() {
  refreshScreensaverBadge();
  if (unreadCount == 0) {
    lv_obj_add_flag(newBadge, LV_OBJ_FLAG_HIDDEN);
    return;
  }
  lv_label_set_text_fmt(newBadge, "%u new", unreadCount);
  lv_obj_clear_flag(newBadge, LV_OBJ_FLAG_HIDDEN);
}

void clearUnread(lv_event_t *event) {
  (void)event;
  if (unreadCount == 0) {
    return;
  }
  const uint32_t childCount = lv_obj_get_child_cnt(messageList);
  for (uint32_t index = 0; index < childCount; ++index) {
    lv_obj_remove_style(lv_obj_get_child(messageList, index), &unreadStyle, LV_PART_MAIN);
  }
  unreadCount = 0;
  refreshUnreadBadge();
}

void addMessageCard(const char *sender, const char *meta, const char *text, bool unread) {
  if (emptyLabel != nullptr) {
    lv_obj_del(emptyLabel);
    emptyLabel = nullptr;
  }

  lv_obj_t *card = lv_obj_create(messageList);
  lv_obj_remove_style_all(card);
  lv_obj_add_style(card, &cardStyle, LV_PART_MAIN);
  if (unread) {
    lv_obj_add_style(card, &unreadStyle, LV_PART_MAIN);
  }
  lv_obj_set_size(card, lv_pct(100), LV_SIZE_CONTENT);
  lv_obj_clear_flag(card, LV_OBJ_FLAG_CLICKABLE | LV_OBJ_FLAG_SCROLLABLE);

  lv_obj_t *senderLabel = lv_label_create(card);
  lv_label_set_long_mode(senderLabel, LV_LABEL_LONG_DOT);
  lv_obj_set_size(senderLabel, 170, 17);
  lv_label_set_text(senderLabel, sender);
  lv_obj_set_style_text_color(senderLabel, lv_color_hex(kColorSender), LV_PART_MAIN);
  lv_obj_align(senderLabel, LV_ALIGN_TOP_LEFT, 0, 0);

  lv_obj_t *metaLabel = lv_label_create(card);
  lv_label_set_text(metaLabel, meta);
  lv_obj_set_style_text_font(metaLabel, &lv_font_montserrat_12, LV_PART_MAIN);
  lv_obj_set_style_text_color(metaLabel, lv_color_hex(kColorMuted), LV_PART_MAIN);
  lv_obj_align(metaLabel, LV_ALIGN_TOP_RIGHT, 0, 1);

  lv_obj_t *textLabel = lv_label_create(card);
  lv_obj_set_width(textLabel, lv_pct(100));
  lv_label_set_long_mode(textLabel, LV_LABEL_LONG_WRAP);
  lv_label_set_text(textLabel, text);
  lv_obj_set_style_text_color(textLabel, lv_color_white(), LV_PART_MAIN);
  lv_obj_set_pos(textLabel, 0, 19);

  lv_obj_move_to_index(card, 0);
  while (lv_obj_get_child_cnt(messageList) > kMaxMessages) {
    lv_obj_del(lv_obj_get_child(messageList, -1));
  }

  if (unread) {
    ++unreadCount;
    refreshUnreadBadge();
  }
}

// "14:32" for today, "Tue 14:32" for older messages.
void formatMessageTime(time_t timestamp, char *destination, size_t destinationSize) {
  const time_t now = time(nullptr);
  if (timestamp < kValidEpoch || now < kValidEpoch) {
    formatClock(timestamp, destination, destinationSize);
    return;
  }
  struct tm messageTime {};
  struct tm today {};
  localtime_r(&timestamp, &messageTime);
  localtime_r(&now, &today);
  const bool sameDay = messageTime.tm_yday == today.tm_yday && messageTime.tm_year == today.tm_year;
  strftime(destination, destinationSize, sameDay ? "%H:%M" : "%a %H:%M", &messageTime);
}

void displayMessage(const StoredMessage &message, bool unread) {
  char clock[16];
  formatMessageTime(static_cast<time_t>(message.timestamp), clock, sizeof(clock));
  char meta[40];
  snprintf(meta, sizeof(meta), "%s  %s", message.channel, clock);
  addMessageCard(message.sender, meta, message.text, unread);
  onScreensaverMessage(unread);
}

uint32_t storedMessageCrc(const StoredMessage &message) {
  return esp_rom_crc32_le(0, reinterpret_cast<const uint8_t *>(&message), offsetof(StoredMessage, crc));
}

bool isValidStoredMessage(const StoredMessage &message) {
  return message.magic == kStoredMessageMagic && message.sequence != 0 && message.crc == storedMessageCrc(message);
}

bool isRecentPacket(uint32_t packetId) {
  if (packetId == 0) {
    return false;
  }
  for (uint8_t index = 0; index < kRecentPacketIds; ++index) {
    if (recentPacketIds[index] == packetId) {
      return true;
    }
  }
  return false;
}

void rememberPacketId(uint32_t packetId) {
  if (packetId == 0) {
    return;
  }
  recentPacketIds[recentPacketIdIndex] = packetId;
  recentPacketIdIndex = (recentPacketIdIndex + 1) % kRecentPacketIds;
}

// Mounts the data partition and makes sure the ring file exists at full size.
void initMessageStore() {
  if (!LittleFS.begin(true)) {
    Serial.println("Message store: LittleFS mount failed, history disabled");
    return;
  }

  constexpr size_t kStoreSize = sizeof(StoredMessage) * kStoredMessageSlots;
  if (!LittleFS.exists(kMessageStorePath) || LittleFS.open(kMessageStorePath, "r").size() != kStoreSize) {
    File file = LittleFS.open(kMessageStorePath, "w");
    if (!file) {
      Serial.println("Message store: cannot create file, history disabled");
      return;
    }
    const StoredMessage empty{};
    for (uint16_t slot = 0; slot < kStoredMessageSlots; ++slot) {
      file.write(reinterpret_cast<const uint8_t *>(&empty), sizeof(empty));
    }
    file.close();
    Serial.println("Message store: created empty history");
  }
  messageStoreReady = true;
}

void storeMessage(StoredMessage &message) {
  if (!messageStoreReady) {
    return;
  }
  message.magic = kStoredMessageMagic;
  message.sequence = nextStoreSequence++;
  message.crc = storedMessageCrc(message);

  File file = LittleFS.open(kMessageStorePath, "r+");
  if (!file || !file.seek(static_cast<uint32_t>(nextStoreSlot) * sizeof(StoredMessage)) ||
      file.write(reinterpret_cast<const uint8_t *>(&message), sizeof(message)) != sizeof(message)) {
    Serial.println("Message store: write failed");
  }
  file.close();
  nextStoreSlot = (nextStoreSlot + 1) % kStoredMessageSlots;
  if (storedMessageCount < kStoredMessageSlots) {
    ++storedMessageCount;
  }
}

// Finds the write position and shows the newest stored messages: those from the last
// 24 hours when the time is known, otherwise simply the newest ones.
void restoreMessages() {
  if (!messageStoreReady) {
    return;
  }
  File file = LittleFS.open(kMessageStorePath, "r");
  if (!file) {
    return;
  }

  const time_t now = time(nullptr);
  const bool timeKnown = now >= kValidEpoch;
  uint32_t newestSequence = 0;
  uint32_t sequences[kMaxMessages];
  uint16_t slots[kMaxMessages];
  uint8_t count = 0;
  StoredMessage message{};

  for (uint16_t slot = 0; slot < kStoredMessageSlots; ++slot) {
    if (file.read(reinterpret_cast<uint8_t *>(&message), sizeof(message)) != sizeof(message)) {
      break;
    }
    if (!isValidStoredMessage(message)) {
      continue;
    }
    ++storedMessageCount;
    if (message.sequence > newestSequence) {
      newestSequence = message.sequence;
      nextStoreSlot = (slot + 1) % kStoredMessageSlots;
    }
    if (timeKnown && (message.timestamp < kValidEpoch || now - message.timestamp > kHistoryWindowSeconds)) {
      continue;
    }

    // Keep the kMaxMessages highest sequence numbers, sorted ascending.
    if (count == kMaxMessages && message.sequence <= sequences[0]) {
      continue;
    }
    uint8_t position = count;
    if (count == kMaxMessages) {
      for (uint8_t index = 1; index < count; ++index) {
        sequences[index - 1] = sequences[index];
        slots[index - 1] = slots[index];
      }
      position = count - 1;
    } else {
      ++count;
    }
    while (position > 0 && sequences[position - 1] > message.sequence) {
      sequences[position] = sequences[position - 1];
      slots[position] = slots[position - 1];
      --position;
    }
    sequences[position] = message.sequence;
    slots[position] = slot;
  }
  nextStoreSequence = newestSequence + 1;

  for (uint8_t index = 0; index < count; ++index) {
    if (file.seek(static_cast<uint32_t>(slots[index]) * sizeof(StoredMessage)) &&
        file.read(reinterpret_cast<uint8_t *>(&message), sizeof(message)) == sizeof(message) &&
        isValidStoredMessage(message)) {
      rememberPacketId(message.packetId);
      displayMessage(message, false);
    }
  }
  file.close();
  Serial.printf("Message store: restored %u messages%s\n", count, timeKnown ? " from the last 24 h" : "");
}

void showTextMessage(uint32_t packetId, uint32_t sender, uint32_t to, uint32_t channel, uint32_t rxTime,
                     const uint8_t *payload, size_t payloadLength) {
  // The radio may resend queued messages after a reconnect.
  if (isRecentPacket(packetId)) {
    return;
  }

  StoredMessage message{};
  foldToAscii(payload, payloadLength, message.text, sizeof(message.text));
  if (message.text[0] == '\0') {
    return;
  }
  rememberPacketId(packetId);

  message.packetId = packetId;
  nodeDisplayName(sender, message.sender, sizeof(message.sender));
  channelDisplayName(channel, to, message.channel, sizeof(message.channel));
  const time_t now = time(nullptr);
  message.timestamp = rxTime >= kValidEpoch ? rxTime : (now >= kValidEpoch ? static_cast<uint32_t>(now) : 0);

  Serial.printf("[%s] %s: %s\n", message.channel, message.sender, message.text);
  storeMessage(message);
  displayMessage(message, true);
}

// User.long_name (field 2) from a User protobuf, folded to ASCII.
void parseUserLongName(const uint8_t *data, size_t length, char *destination, size_t destinationSize) {
  destination[0] = '\0';
  size_t offset = 0;
  ProtoField field{};
  while (offset < length && readProtoField(data, length, offset, field)) {
    if (field.number == 2 && field.wireType == 2) {
      foldToAscii(field.bytes, field.length, destination, destinationSize);
      return;
    }
  }
}

// DeviceMetrics.battery_level (field 1).
bool parseBatteryLevel(const uint8_t *data, size_t length, uint8_t &battery) {
  size_t offset = 0;
  ProtoField field{};
  while (offset < length && readProtoField(data, length, offset, field)) {
    if (field.number == 1 && field.wireType == 0) {
      battery = static_cast<uint8_t>(field.integer > 101 ? 101 : field.integer);
      return true;
    }
  }
  return false;
}

// User short_name (3), hw_model (5), role (7) of the local radio.
void parseLocalUser(const uint8_t *data, size_t length) {
  size_t offset = 0;
  ProtoField field{};
  radioInfo.hasUser = true;
  while (offset < length && readProtoField(data, length, offset, field)) {
    if (field.number == 3 && field.wireType == 2) {
      foldToAscii(field.bytes, field.length, radioInfo.shortName, sizeof(radioInfo.shortName));
    } else if (field.number == 5 && field.wireType == 0) {
      radioInfo.hwModel = static_cast<uint8_t>(field.integer);
    } else if (field.number == 7 && field.wireType == 0) {
      radioInfo.role = static_cast<uint8_t>(field.integer);
    }
  }
}

// DeviceMetrics of the local radio.
void parseLocalMetrics(const uint8_t *data, size_t length) {
  size_t offset = 0;
  ProtoField field{};
  while (offset < length && readProtoField(data, length, offset, field)) {
    if (field.number == 1 && field.wireType == 0) {
      radioInfo.hasBattery = true;
      radioInfo.battery = static_cast<uint8_t>(field.integer > 101 ? 101 : field.integer);
    } else if (field.number == 2 && field.wireType == 5) {
      radioInfo.hasVoltage = true;
      radioInfo.voltage = fixed32ToFloat(field.fixed32);
    } else if (field.number == 3 && field.wireType == 5) {
      radioInfo.hasChannelUtil = true;
      radioInfo.channelUtil = fixed32ToFloat(field.fixed32);
    } else if (field.number == 4 && field.wireType == 5) {
      radioInfo.hasAirUtilTx = true;
      radioInfo.airUtilTx = fixed32ToFloat(field.fixed32);
    } else if (field.number == 5 && field.wireType == 0) {
      radioInfo.hasUptime = true;
      radioInfo.uptimeSeconds = static_cast<uint32_t>(field.integer);
    }
  }
  radioInfo.metricsAt = millis();
}

// Position latitude_i (1), longitude_i (2), altitude (3) of the local radio.
void parseLocalPosition(const uint8_t *data, size_t length) {
  size_t offset = 0;
  ProtoField field{};
  bool hasLatitude = false;
  bool hasLongitude = false;
  while (offset < length && readProtoField(data, length, offset, field)) {
    if (field.number == 1 && field.wireType == 5) {
      radioInfo.latitudeI = static_cast<int32_t>(field.fixed32);
      hasLatitude = true;
    } else if (field.number == 2 && field.wireType == 5) {
      radioInfo.longitudeI = static_cast<int32_t>(field.fixed32);
      hasLongitude = true;
    } else if (field.number == 3 && field.wireType == 0) {
      radioInfo.altitude = static_cast<int32_t>(field.integer);
      radioInfo.hasAltitude = true;
    }
  }
  radioInfo.hasPosition = hasLatitude && hasLongitude && (radioInfo.latitudeI != 0 || radioInfo.longitudeI != 0);
}

// Config.lora (field 6): use_preset 1, modem_preset 2, region 7, hop_limit 8, tx_power 10.
void parseConfig(const uint8_t *data, size_t length) {
  size_t offset = 0;
  ProtoField field{};
  while (offset < length && readProtoField(data, length, offset, field)) {
    if (field.number != 6 || field.wireType != 2) {
      continue;
    }
    radioInfo.hasLora = true;
    radioInfo.usePreset = false;
    radioInfo.modemPreset = 0;
    radioInfo.region = 0;
    radioInfo.hopLimit = 0;
    radioInfo.txPower = 0;
    size_t loraOffset = 0;
    ProtoField loraField{};
    while (loraOffset < field.length && readProtoField(field.bytes, field.length, loraOffset, loraField)) {
      if (loraField.wireType != 0) {
        continue;
      }
      if (loraField.number == 1) {
        radioInfo.usePreset = loraField.integer != 0;
      } else if (loraField.number == 2) {
        radioInfo.modemPreset = static_cast<uint8_t>(loraField.integer);
      } else if (loraField.number == 7) {
        radioInfo.region = static_cast<uint8_t>(loraField.integer);
      } else if (loraField.number == 8) {
        radioInfo.hopLimit = static_cast<uint8_t>(loraField.integer);
      } else if (loraField.number == 10) {
        radioInfo.txPower = static_cast<int32_t>(loraField.integer);
      }
    }
  }
}

// DeviceMetadata.firmware_version (field 1).
void parseMetadata(const uint8_t *data, size_t length) {
  size_t offset = 0;
  ProtoField field{};
  while (offset < length && readProtoField(data, length, offset, field)) {
    if (field.number == 1 && field.wireType == 2) {
      foldToAscii(field.bytes, field.length, radioInfo.firmware, sizeof(radioInfo.firmware));
    }
  }
}

void parseNodeInfo(const uint8_t *data, size_t length) {
  size_t offset = 0;
  NodeEntry info{};
  info.hopsAway = kUnknownHops;
  ProtoField field{};

  while (offset < length && readProtoField(data, length, offset, field)) {
    if (field.number == 1 && field.wireType == 0) {
      info.number = static_cast<uint32_t>(field.integer);
    } else if (field.number == 2 && field.wireType == 2) {
      parseUserLongName(field.bytes, field.length, info.name, sizeof(info.name));
    } else if (field.number == 4 && field.wireType == 5) {
      info.snr = fixed32ToFloat(field.fixed32);
    } else if (field.number == 5 && field.wireType == 5) {
      info.lastHeard = field.fixed32;
    } else if (field.number == 6 && field.wireType == 2) {
      parseBatteryLevel(field.bytes, field.length, info.battery);
    } else if (field.number == 8 && field.wireType == 0) {
      info.viaMqtt = field.integer != 0;
    } else if (field.number == 9 && field.wireType == 0) {
      info.hopsAway = static_cast<uint8_t>(field.integer);
    }
  }

  if (info.number != 0 && info.number == localNodeNumber) {
    offset = 0;
    while (offset < length && readProtoField(data, length, offset, field)) {
      if (field.number == 2 && field.wireType == 2) {
        parseLocalUser(field.bytes, field.length);
      } else if (field.number == 3 && field.wireType == 2) {
        parseLocalPosition(field.bytes, field.length);
      } else if (field.number == 6 && field.wireType == 2) {
        parseLocalMetrics(field.bytes, field.length);
      }
    }
  }

  NodeEntry *entry = findOrAddNode(info.number);
  if (entry == nullptr) {
    return;
  }
  if (info.name[0] == '\0') {
    snprintf(info.name, sizeof(info.name), "%s", entry->name);
  }
  *entry = info;
}

// Telemetry.device_metrics (field 2) carries the sender's battery level; for the
// local radio it also refreshes the Info page.
void parseTelemetry(uint32_t sender, NodeEntry *node, const uint8_t *data, size_t length) {
  size_t offset = 0;
  ProtoField field{};
  while (offset < length && readProtoField(data, length, offset, field)) {
    if (field.number != 2 || field.wireType != 2) {
      continue;
    }
    if (sender != 0 && sender == localNodeNumber) {
      parseLocalMetrics(field.bytes, field.length);
    } else if (node != nullptr) {
      parseBatteryLevel(field.bytes, field.length, node->battery);
    }
  }
}

void parseChannel(const uint8_t *data, size_t length) {
  size_t offset = 0;
  uint32_t channelIndex = 0;
  uint32_t role = 0;
  char name[16] = {};
  ProtoField field{};

  while (offset < length && readProtoField(data, length, offset, field)) {
    if (field.number == 1 && field.wireType == 0) {
      channelIndex = static_cast<uint32_t>(field.integer);
    } else if (field.number == 3 && field.wireType == 0) {
      role = static_cast<uint32_t>(field.integer);
    } else if (field.number == 2 && field.wireType == 2) {
      size_t settingsOffset = 0;
      ProtoField settingsField{};
      while (settingsOffset < field.length &&
             readProtoField(field.bytes, field.length, settingsOffset, settingsField)) {
        if (settingsField.number == 3 && settingsField.wireType == 2) {
          foldToAscii(settingsField.bytes, settingsField.length, name, sizeof(name));
        }
      }
    }
  }

  if (channelIndex < kMaxChannels) {
    snprintf(channelNames[channelIndex], sizeof(channelNames[channelIndex]), "%s", name);
    channelEnabled[channelIndex] = role != 0;
  }
}

void parseMeshPacket(const uint8_t *data, size_t length) {
  size_t offset = 0;
  uint32_t sender = 0;
  uint32_t to = 0;
  uint32_t channel = 0;
  uint32_t rxTime = 0;
  uint32_t packetId = 0;
  uint32_t hopStart = 0;
  uint32_t hopLimit = 0;
  float rxSnr = 0;
  bool viaMqtt = false;
  const uint8_t *decodedData = nullptr;
  size_t decodedLength = 0;
  ProtoField field{};

  while (offset < length && readProtoField(data, length, offset, field)) {
    if (field.number == 1 && field.wireType == 5) {
      sender = field.fixed32;
    } else if (field.number == 2 && field.wireType == 5) {
      to = field.fixed32;
    } else if (field.number == 3 && field.wireType == 0) {
      channel = static_cast<uint32_t>(field.integer);
    } else if (field.number == 4 && field.wireType == 2) {
      decodedData = field.bytes;
      decodedLength = field.length;
    } else if (field.number == 6 && field.wireType == 5) {
      packetId = field.fixed32;
    } else if (field.number == 7 && field.wireType == 5) {
      rxTime = field.fixed32;
    } else if (field.number == 8 && field.wireType == 5) {
      rxSnr = fixed32ToFloat(field.fixed32);
    } else if (field.number == 9 && field.wireType == 0) {
      hopLimit = static_cast<uint32_t>(field.integer);
    } else if (field.number == 14 && field.wireType == 0) {
      viaMqtt = field.integer != 0;
    } else if (field.number == 15 && field.wireType == 0) {
      hopStart = static_cast<uint32_t>(field.integer);
    }
  }

  ++packetCount;
  lastPacketAt = millis();

  NodeEntry *node = sender != localNodeNumber ? findOrAddNode(sender) : nullptr;
  if (node != nullptr) {
    const time_t now = time(nullptr);
    node->lastHeard = rxTime >= kValidEpoch ? rxTime : (now >= kValidEpoch ? static_cast<uint32_t>(now) : 0);
    node->viaMqtt = viaMqtt;
    if (hopStart > 0 && hopStart >= hopLimit) {
      node->hopsAway = static_cast<uint8_t>(hopStart - hopLimit);
    }
    if (node->hopsAway == 0 && rxSnr != 0) {
      node->snr = rxSnr;
    }
  }

  // Packets without a decoded payload are on channels this node has no key for.
  if (decodedData == nullptr) {
    return;
  }

  offset = 0;
  uint32_t portNumber = 0;
  const uint8_t *payload = nullptr;
  size_t payloadLength = 0;
  while (offset < decodedLength && readProtoField(decodedData, decodedLength, offset, field)) {
    if (field.number == 1 && field.wireType == 0) {
      portNumber = static_cast<uint32_t>(field.integer);
    } else if (field.number == 2 && field.wireType == 2) {
      payload = field.bytes;
      payloadLength = field.length;
    }
  }

  if (portNumber == kPortTextMessage && payload != nullptr) {
    showTextMessage(packetId, sender, to, channel, rxTime, payload, payloadLength);
  } else if (portNumber == kPortNodeInfo && payload != nullptr) {
    char nodeName[32];
    parseUserLongName(payload, payloadLength, nodeName, sizeof(nodeName));
    rememberNodeName(sender, nodeName);
  } else if (portNumber == kPortTelemetry && payload != nullptr) {
    parseTelemetry(sender, node, payload, payloadLength);
  }
}

void handleFromRadio(const uint8_t *data, size_t length) {
  size_t offset = 0;
  ProtoField field{};
  while (offset < length && readProtoField(data, length, offset, field)) {
    if (field.wireType == 2 && field.number == 2) {
      parseMeshPacket(field.bytes, field.length);
    } else if (field.wireType == 2 && field.number == 4) {
      parseNodeInfo(field.bytes, field.length);
    } else if (field.wireType == 2 && field.number == 10) {
      parseChannel(field.bytes, field.length);
    } else if (field.wireType == 2 && field.number == 5) {
      parseConfig(field.bytes, field.length);
    } else if (field.wireType == 2 && field.number == 13) {
      parseMetadata(field.bytes, field.length);
    } else if (field.wireType == 2 && field.number == 3) {
      size_t infoOffset = 0;
      ProtoField infoField{};
      while (infoOffset < field.length && readProtoField(field.bytes, field.length, infoOffset, infoField)) {
        if (infoField.number == 1 && infoField.wireType == 0) {
          localNodeNumber = static_cast<uint32_t>(infoField.integer);
        } else if (infoField.number == 8 && infoField.wireType == 0) {
          radioInfo.hasRebootCount = true;
          radioInfo.rebootCount = static_cast<uint32_t>(infoField.integer);
        }
      }
    } else if (field.number == 7 && field.wireType == 0) {
      Serial.printf("Node database loaded: %u nodes\n", nodeCount);
      setLinkState(LinkState::Ready);
    }
  }
}

void processApiByte(uint8_t byte) {
  if (apiExpectedLength == 0) {
    if (apiHeaderLength == 0) {
      if (byte == 0x94) {
        apiHeader[0] = byte;
        apiHeaderLength = 1;
      }
      return;
    }
    if (apiHeaderLength == 1 && byte != 0xC3) {
      apiHeaderLength = byte == 0x94 ? 1 : 0;
      apiHeader[0] = byte;
      return;
    }
    apiHeader[apiHeaderLength++] = byte;
    if (apiHeaderLength == sizeof(apiHeader)) {
      apiExpectedLength = (static_cast<uint16_t>(apiHeader[2]) << 8) | apiHeader[3];
      apiHeaderLength = 0;
      if (apiExpectedLength == 0 || apiExpectedLength > sizeof(apiFrame)) {
        apiExpectedLength = 0;
      } else {
        apiReceivedLength = 0;
      }
    }
    return;
  }

  apiFrame[apiReceivedLength++] = byte;
  if (apiReceivedLength == apiExpectedLength) {
    handleFromRadio(apiFrame, apiExpectedLength);
    apiExpectedLength = 0;
    apiReceivedLength = 0;
  }
}

bool loadRadioAddress() {
  preferences.begin("radio", false);  // read-only would log an error while nothing is saved yet
  const uint32_t stored = preferences.getUInt("ip", 0);
  preferences.end();
  if (stored == 0) {
    return false;
  }
  radioAddress = IPAddress(stored);
  return true;
}

void saveRadioAddress(const IPAddress &address) {
  preferences.begin("radio", false);
  preferences.putUInt("ip", static_cast<uint32_t>(address));
  preferences.end();
}

// Probes every host on the local /24 for an open Meshtastic API port, using a batch
// of non-blocking connects at a time. Returns the first host that accepts.
bool scanForRadio(IPAddress &found) {
  const IPAddress local = WiFi.localIP();
  Serial.printf("Scanning %u.%u.%u.0/24 for TCP port %u\n", local[0], local[1], local[2], kRadioPort);

  for (uint16_t first = 1; first < 255; first += kScanBatchSize) {
    char splashText[64];
    snprintf(splashText, sizeof(splashText), "Searching for radio... %u.%u.%u.%u", local[0], local[1], local[2],
             first);
    setSplashStatus(splashText);

    int sockets[kScanBatchSize];
    uint8_t hosts[kScanBatchSize];
    uint8_t count = 0;
    for (uint16_t host = first; host < first + kScanBatchSize && host < 255; ++host) {
      if (host == local[3]) {
        continue;
      }
      const int sock = socket(AF_INET, SOCK_STREAM, IPPROTO_TCP);
      if (sock < 0) {
        continue;
      }
      fcntl(sock, F_SETFL, fcntl(sock, F_GETFL, 0) | O_NONBLOCK);
      sockaddr_in address{};
      address.sin_family = AF_INET;
      address.sin_port = htons(kRadioPort);
      address.sin_addr.s_addr = static_cast<uint32_t>(IPAddress(local[0], local[1], local[2], host));
      if (lwip_connect(sock, reinterpret_cast<sockaddr *>(&address), sizeof(address)) == 0 || errno == EINPROGRESS) {
        sockets[count] = sock;
        hosts[count] = static_cast<uint8_t>(host);
        ++count;
      } else {
        ::close(sock);
      }
    }

    int foundHost = -1;
    uint8_t pending = count;
    const uint32_t start = millis();
    while (pending > 0 && foundHost < 0 && millis() - start < kScanBatchTimeoutMs) {
      fd_set writable;
      FD_ZERO(&writable);
      int maxSocket = -1;
      for (uint8_t index = 0; index < count; ++index) {
        if (sockets[index] >= 0) {
          FD_SET(sockets[index], &writable);
          maxSocket = max(maxSocket, sockets[index]);
        }
      }
      timeval wait{0, 20000};
      if (select(maxSocket + 1, nullptr, &writable, nullptr, &wait) > 0) {
        for (uint8_t index = 0; index < count; ++index) {
          if (sockets[index] < 0 || !FD_ISSET(sockets[index], &writable)) {
            continue;
          }
          int error = 0;
          socklen_t length = sizeof(error);
          getsockopt(sockets[index], SOL_SOCKET, SO_ERROR, &error, &length);
          if (error == 0 && foundHost < 0) {
            foundHost = hosts[index];
          }
          ::close(sockets[index]);
          sockets[index] = -1;
          --pending;
        }
      }
      lv_timer_handler();
    }

    for (uint8_t index = 0; index < count; ++index) {
      if (sockets[index] >= 0) {
        ::close(sockets[index]);
      }
    }
    if (foundHost >= 0) {
      found = IPAddress(local[0], local[1], local[2], static_cast<uint8_t>(foundHost));
      Serial.printf("Found Meshtastic API at %s\n", found.toString().c_str());
      return true;
    }
  }

  Serial.println("No Meshtastic API found on the local network");
  return false;
}

void startRadioApi() {
  radioClient.stop();

  // Discover the radio when none is known yet, or the known address keeps failing.
  if (!hasRadioAddress || failedConnects >= kRescanAfterFailures) {
    setLinkState(LinkState::Searching);
    IPAddress found;
    if (!scanForRadio(found)) {
      radioRetryMs = kRadioRescanRetryMs;
      setLinkState(LinkState::NotFound);
      return;
    }
    radioAddress = found;
    hasRadioAddress = true;
    failedConnects = 0;
    saveRadioAddress(found);
  }
  radioRetryMs = kRadioRetryMs;

  setLinkState(LinkState::Connecting);
  const String host = radioAddress.toString();
  Serial.printf("Connecting to Meshtastic API at %s:%u\n", host.c_str(), kRadioPort);
  char splashText[64];
  snprintf(splashText, sizeof(splashText), "Connecting to radio %s...", host.c_str());
  setSplashStatus(splashText);
  if (!radioClient.connect(radioAddress, kRadioPort, kRadioConnectTimeoutMs)) {
    Serial.println("Meshtastic API connection failed");
    ++failedConnects;
    setLinkState(LinkState::Down);
    return;
  }

  failedConnects = 0;
  radioApiConnected = true;
  radioInfo = RadioInfo{};
  memset(channelEnabled, 0, sizeof(channelEnabled));
  apiHeaderLength = 0;
  apiExpectedLength = 0;
  apiReceivedLength = 0;
  lastHeartbeatAt = millis();
  setLinkState(LinkState::Loading);
  // ToRadio { want_config_id: 1 }
  const uint8_t configRequest[] = {0x94, 0xC3, 0x00, 0x02, 0x18, 0x01};
  radioClient.write(configRequest, sizeof(configRequest));
}

void sendHeartbeat() {
  // ToRadio { heartbeat: {} } keeps the node from dropping an idle API client.
  const uint8_t heartbeat[] = {0x94, 0xC3, 0x00, 0x02, 0x3A, 0x00};
  radioClient.write(heartbeat, sizeof(heartbeat));
  lastHeartbeatAt = millis();
}

void serviceRadioApi() {
  if (WiFi.status() != WL_CONNECTED) {
    return;
  }

  if (!radioClient.connected()) {
    if (radioApiConnected) {
      radioApiConnected = false;
      setLinkState(LinkState::Down);
    }
    if (hasRadioConnectAttempted && millis() - lastRadioConnectAttempt < radioRetryMs) {
      return;
    }
    hasRadioConnectAttempted = true;
    lastRadioConnectAttempt = millis();
    startRadioApi();
    return;
  }

  while (radioClient.available() > 0) {
    processApiByte(static_cast<uint8_t>(radioClient.read()));
  }

  if (millis() - lastHeartbeatAt >= kHeartbeatIntervalMs) {
    sendHeartbeat();
  }
}

uint16_t readTouchData(uint8_t command) {
  touchSpi.beginTransaction(SPISettings(touchSpiFrequency, MSBFIRST, SPI_MODE0));
  digitalWrite(touchCs, LOW);
  touchSpi.transfer(command);
  const uint16_t value = (touchSpi.transfer(0x00) << 8) | touchSpi.transfer(0x00);
  digitalWrite(touchCs, HIGH);
  touchSpi.endTransaction();

  return value >> 3;
}

bool readTouch(uint16_t &x, uint16_t &y) {
  if (digitalRead(touchIrq) == HIGH) {
    return false;
  }

  uint32_t rawX = 0;
  uint32_t rawY = 0;

  for (uint8_t i = 0; i < 4; ++i) {
    rawX += readTouchData(0xD0);
    rawY += readTouchData(0x90);
  }

  rawX /= 4;
  rawY /= 4;

  const uint16_t z1 = readTouchData(0xB0);
  const uint16_t z2 = readTouchData(0xC0);
  const uint16_t pressure = z1 + 4095 - z2;
  if (pressure < touchPressureThreshold) {
    return false;
  }

  const uint16_t nativeX =
      constrain(map(rawX, touchRawMinX, touchRawMaxX, 0, nativeScreenWidth - 1), 0, nativeScreenWidth - 1);
  const uint16_t nativeY =
      constrain(map(rawY, touchRawMinY, touchRawMaxY, 0, nativeScreenHeight - 1), 0, nativeScreenHeight - 1);

  switch (displayRotation % 4) {
    case 0:
      x = nativeX;
      y = nativeY;
      break;
    case 1:
      x = nativeY;
      y = nativeX;
      break;
    case 2:
      x = nativeScreenWidth - 1 - nativeX;
      y = nativeScreenHeight - 1 - nativeY;
      break;
    case 3:
    default:
      x = nativeScreenHeight - 1 - nativeY;
      y = nativeScreenWidth - 1 - nativeX;
      break;
  }

  return true;
}

void flushDisplay(lv_disp_drv_t *disp, const lv_area_t *area, lv_color_t *color_p) {
  const uint32_t width = area->x2 - area->x1 + 1;
  const uint32_t height = area->y2 - area->y1 + 1;

  tft.startWrite();
  tft.setAddrWindow(area->x1, area->y1, width, height);
  tft.pushColors(reinterpret_cast<uint16_t *>(&color_p->full), width * height, true);
  tft.endWrite();

  lv_disp_flush_ready(disp);
}

void readTouchForLvgl(lv_indev_drv_t *indev, lv_indev_data_t *data) {
  static uint16_t lastX = 0;
  static uint16_t lastY = 0;
  uint16_t x = 0;
  uint16_t y = 0;

  if (readTouch(x, y)) {
    lastX = x;
    lastY = y;
    data->state = LV_INDEV_STATE_PR;
  } else {
    data->state = LV_INDEV_STATE_REL;
  }
  data->point.x = lastX;
  data->point.y = lastY;

  (void)indev;
}

void formatHeard(uint32_t lastHeard, time_t now, char *destination, size_t destinationSize) {
  if (lastHeard == 0 || now < kValidEpoch) {
    snprintf(destination, destinationSize, "-");
    return;
  }
  const uint32_t seconds = now > static_cast<time_t>(lastHeard) ? static_cast<uint32_t>(now - lastHeard) : 0;
  if (seconds < 60) {
    snprintf(destination, destinationSize, "now");
  } else if (seconds < 3600) {
    snprintf(destination, destinationSize, "%lum", static_cast<unsigned long>(seconds / 60));
  } else if (seconds < 86400) {
    snprintf(destination, destinationSize, "%luh", static_cast<unsigned long>(seconds / 3600));
  } else {
    snprintf(destination, destinationSize, "%lud", static_cast<unsigned long>(seconds / 86400));
  }
}

void formatRoute(const NodeEntry &node, char *destination, size_t destinationSize) {
  if (node.viaMqtt) {
    snprintf(destination, destinationSize, "MQTT");
  } else if (node.hopsAway == kUnknownHops) {
    snprintf(destination, destinationSize, "-");
  } else if (node.hopsAway == 0) {
    if (node.snr != 0) {
      snprintf(destination, destinationSize, "%.1f dB", node.snr);
    } else {
      snprintf(destination, destinationSize, "direct");
    }
  } else {
    snprintf(destination, destinationSize, "%u hop%s", node.hopsAway, node.hopsAway == 1 ? "" : "s");
  }
}

void formatBattery(uint8_t battery, char *destination, size_t destinationSize) {
  if (battery == 0) {
    destination[0] = '\0';
  } else if (battery > 100) {
    snprintf(destination, destinationSize, "PWR");
  } else {
    snprintf(destination, destinationSize, "%u%%", battery);
  }
}

// Rebuilds the node table, most recently heard first. The local node is left out.
void refreshNodeTable() {
  uint8_t order[kMaxNodes];
  uint8_t rowCount = 0;
  for (uint8_t index = 0; index < nodeCount; ++index) {
    if (nodes[index].number == localNodeNumber) {
      continue;
    }
    uint8_t position = rowCount++;
    while (position > 0 && nodes[order[position - 1]].lastHeard < nodes[index].lastHeard) {
      order[position] = order[position - 1];
      --position;
    }
    order[position] = index;
  }

  if (rowCount == 0) {
    lv_table_set_row_cnt(nodeTable, 1);
    lv_table_set_cell_value(nodeTable, 0, 0, "Waiting for node list...");
    for (uint8_t column = 1; column < kNodeColumns; ++column) {
      lv_table_set_cell_value(nodeTable, 0, column, "");
    }
  } else {
    lv_table_set_row_cnt(nodeTable, rowCount);
    const time_t now = time(nullptr);
    for (uint8_t row = 0; row < rowCount; ++row) {
      const NodeEntry &node = nodes[order[row]];
      char name[32];
      char heard[8];
      char route[12];
      char battery[8];
      nodeDisplayName(node.number, name, sizeof(name));
      formatHeard(node.lastHeard, now, heard, sizeof(heard));
      formatRoute(node, route, sizeof(route));
      formatBattery(node.battery, battery, sizeof(battery));
      lv_table_set_cell_value(nodeTable, row, 0, name);
      lv_table_set_cell_value(nodeTable, row, 1, heard);
      lv_table_set_cell_value(nodeTable, row, 2, route);
      lv_table_set_cell_value(nodeTable, row, 3, battery);
      lv_table_add_cell_ctrl(nodeTable, row, 0, LV_TABLE_CELL_CTRL_TEXT_CROP);
    }
  }

  nodeTableDirty = false;
  lastNodeTableRefresh = millis();
}

// Name column in the sender color, the other columns smaller, muted and right-aligned.
void styleNodeCell(lv_event_t *event) {
  lv_obj_draw_part_dsc_t *dsc = lv_event_get_draw_part_dsc(event);
  if (dsc->part != LV_PART_ITEMS || dsc->label_dsc == nullptr) {
    return;
  }
  const uint32_t column = dsc->id % kNodeColumns;
  if (column == 0) {
    dsc->label_dsc->color = lv_color_hex(kColorSender);
    return;
  }
  dsc->label_dsc->font = &lv_font_montserrat_12;
  dsc->label_dsc->align = LV_TEXT_ALIGN_RIGHT;
  dsc->label_dsc->color = column == 1 ? lv_color_white() : lv_color_hex(kColorMuted);
}

void formatDuration(uint32_t seconds, char *destination, size_t destinationSize) {
  const unsigned long days = seconds / 86400;
  const unsigned long hours = (seconds % 86400) / 3600;
  const unsigned long minutes = (seconds % 3600) / 60;
  if (days > 0) {
    snprintf(destination, destinationSize, "%lud %luh", days, hours);
  } else if (hours > 0) {
    snprintf(destination, destinationSize, "%luh %lum", hours, minutes);
  } else {
    snprintf(destination, destinationSize, "%lum %lus", minutes, static_cast<unsigned long>(seconds % 60));
  }
}

uint16_t infoRow = 0;

void addInfoSection(const char *title) {
  lv_table_set_cell_value(infoTable, infoRow, 0, title);
  lv_table_set_cell_value(infoTable, infoRow, 1, "");
  lv_table_add_cell_ctrl(infoTable, infoRow, 0, LV_TABLE_CELL_CTRL_MERGE_RIGHT | LV_TABLE_CELL_CTRL_CUSTOM_1);
  ++infoRow;
}

void addInfoValue(const char *label, const char *value) {
  lv_table_set_cell_value(infoTable, infoRow, 0, label);
  lv_table_set_cell_value(infoTable, infoRow, 1, value != nullptr && value[0] != '\0' ? value : "-");
  ++infoRow;
}

// Rebuilds the Info page. Rows are always the same, unknown values show "-".
void refreshInfoTable() {
  char value[64];
  infoRow = 0;

  addInfoSection("RADIO");
  const NodeEntry *self = localNodeNumber != 0 ? findNode(localNodeNumber) : nullptr;
  if (self != nullptr && self->name[0] != '\0') {
    if (radioInfo.shortName[0] != '\0') {
      snprintf(value, sizeof(value), "%s (%s)", self->name, radioInfo.shortName);
    } else {
      snprintf(value, sizeof(value), "%s", self->name);
    }
  } else {
    value[0] = '\0';
  }
  addInfoValue("Name", value);
  if (localNodeNumber != 0) {
    snprintf(value, sizeof(value), "!%08lx", static_cast<unsigned long>(localNodeNumber));
  } else {
    value[0] = '\0';
  }
  addInfoValue("Node ID", value);
  addInfoValue("Address", hasRadioAddress ? radioAddress.toString().c_str() : nullptr);

  value[0] = '\0';
  if (radioInfo.hasUser) {
    const char *name = enumName(kHardwareModelNames, sizeof(kHardwareModelNames) / sizeof(kHardwareModelNames[0]),
                                radioInfo.hwModel);
    if (name != nullptr) {
      snprintf(value, sizeof(value), "%s", name);
    } else {
      snprintf(value, sizeof(value), "Model %u", radioInfo.hwModel);
    }
  }
  addInfoValue("Hardware", value);
  value[0] = '\0';
  if (radioInfo.hasUser) {
    const char *name = enumName(kRoleNames, sizeof(kRoleNames) / sizeof(kRoleNames[0]), radioInfo.role);
    if (name != nullptr) {
      snprintf(value, sizeof(value), "%s", name);
    } else {
      snprintf(value, sizeof(value), "Role %u", radioInfo.role);
    }
  }
  addInfoValue("Role", value);
  addInfoValue("Firmware", radioInfo.firmware);

  value[0] = '\0';
  if (radioInfo.hasBattery) {
    const int written = radioInfo.battery > 100 ? snprintf(value, sizeof(value), "Powered")
                                                : snprintf(value, sizeof(value), "%u%%", radioInfo.battery);
    if (radioInfo.hasVoltage && written > 0) {
      snprintf(value + written, sizeof(value) - written, " (%.2f V)", radioInfo.voltage);
    }
  }
  addInfoValue("Battery", value);
  value[0] = '\0';
  if (radioInfo.hasChannelUtil) {
    snprintf(value, sizeof(value), "%.1f%%", radioInfo.channelUtil);
  }
  addInfoValue("Channel use", value);
  value[0] = '\0';
  if (radioInfo.hasAirUtilTx) {
    snprintf(value, sizeof(value), "%.1f%%", radioInfo.airUtilTx);
  }
  addInfoValue("Airtime TX", value);
  value[0] = '\0';
  if (radioInfo.hasUptime) {
    formatDuration(radioInfo.uptimeSeconds + (millis() - radioInfo.metricsAt) / 1000, value, sizeof(value));
  }
  addInfoValue("Uptime", value);
  value[0] = '\0';
  if (radioInfo.metricsAt != 0) {
    formatAge(millis() - radioInfo.metricsAt, value, sizeof(value));
  }
  addInfoValue("Metrics from", value);
  value[0] = '\0';
  if (radioInfo.hasRebootCount) {
    snprintf(value, sizeof(value), "%lu", static_cast<unsigned long>(radioInfo.rebootCount));
  }
  addInfoValue("Reboots", value);

  value[0] = '\0';
  if (radioInfo.hasLora) {
    const char *name = enumName(kRegionNames, sizeof(kRegionNames) / sizeof(kRegionNames[0]), radioInfo.region);
    if (name != nullptr) {
      snprintf(value, sizeof(value), "%s", name);
    } else {
      snprintf(value, sizeof(value), "Region %u", radioInfo.region);
    }
  }
  addInfoValue("Region", value);
  value[0] = '\0';
  if (radioInfo.hasLora) {
    if (radioInfo.usePreset) {
      presetDisplayName(radioInfo.modemPreset, value, sizeof(value));
    } else {
      snprintf(value, sizeof(value), "Custom");
    }
  }
  addInfoValue("Preset", value);
  value[0] = '\0';
  if (radioInfo.hasLora) {
    snprintf(value, sizeof(value), "%u", radioInfo.hopLimit);
  }
  addInfoValue("Hop limit", value);
  value[0] = '\0';
  if (radioInfo.hasLora) {
    if (radioInfo.txPower == 0) {
      snprintf(value, sizeof(value), "Default");
    } else {
      snprintf(value, sizeof(value), "%ld dBm", static_cast<long>(radioInfo.txPower));
    }
  }
  addInfoValue("TX power", value);

  value[0] = '\0';
  size_t used = 0;
  for (uint8_t index = 0; index < kMaxChannels && used < sizeof(value); ++index) {
    if (!channelEnabled[index]) {
      continue;
    }
    char name[16];
    channelDisplayName(index, kBroadcastAddress, name, sizeof(name));
    const int written = snprintf(value + used, sizeof(value) - used, "%s%s", used == 0 ? "" : ", ", name);
    if (written > 0) {
      used += static_cast<size_t>(written);
    }
  }
  addInfoValue("Channels", value);
  value[0] = '\0';
  if (radioInfo.hasPosition) {
    snprintf(value, sizeof(value), "%.5f, %.5f", radioInfo.latitudeI / 1e7, radioInfo.longitudeI / 1e7);
  }
  addInfoValue("Position", value);
  value[0] = '\0';
  if (radioInfo.hasPosition && radioInfo.hasAltitude) {
    snprintf(value, sizeof(value), "%ld m", static_cast<long>(radioInfo.altitude));
  }
  addInfoValue("Altitude", value);

  addInfoSection("MESH");
  snprintf(value, sizeof(value), "%u", nodeCount - (self != nullptr ? 1 : 0));
  addInfoValue("Nodes", value);
  snprintf(value, sizeof(value), "%lu", static_cast<unsigned long>(packetCount));
  addInfoValue("Packets heard", value);
  value[0] = '\0';
  if (packetCount > 0) {
    formatAge(millis() - lastPacketAt, value, sizeof(value));
  }
  addInfoValue("Last packet", value);

  addInfoSection("MESHWATCH");
  addInfoValue("Version", MESHWATCH_VERSION);
  if (WiFi.status() == WL_CONNECTED) {
    addInfoValue("IP address", WiFi.localIP().toString().c_str());
    snprintf(value, sizeof(value), "%s (%d dBm)", WiFi.SSID().c_str(), WiFi.RSSI());
    addInfoValue("WiFi", value);
  } else {
    addInfoValue("IP address", nullptr);
    addInfoValue("WiFi", linkState == LinkState::Setup ? "Setup mode" : "Disconnected");
  }
  formatDuration(millis() / 1000, value, sizeof(value));
  addInfoValue("Uptime", value);
  snprintf(value, sizeof(value), "%lu KB", static_cast<unsigned long>(ESP.getFreeHeap() / 1024));
  addInfoValue("Free memory", value);
  snprintf(value, sizeof(value), "%u of %u", storedMessageCount, kStoredMessageSlots);
  addInfoValue("Stored msgs", value);

  lv_table_set_row_cnt(infoTable, infoRow);
}

// Section rows in the accent color, labels muted, values white.
void styleInfoCell(lv_event_t *event) {
  lv_obj_draw_part_dsc_t *dsc = lv_event_get_draw_part_dsc(event);
  if (dsc->part != LV_PART_ITEMS || dsc->label_dsc == nullptr) {
    return;
  }
  const uint16_t row = dsc->id / 2;
  const uint16_t column = dsc->id % 2;
  if (lv_table_has_cell_ctrl(infoTable, row, 0, LV_TABLE_CELL_CTRL_CUSTOM_1)) {
    dsc->label_dsc->color = lv_color_hex(kColorAccent);
  } else {
    dsc->label_dsc->color = column == 0 ? lv_color_hex(kColorMuted) : lv_color_white();
  }
}

void styleTab(lv_obj_t *tab, bool active) {
  lv_obj_set_style_bg_opa(tab, active ? LV_OPA_COVER : LV_OPA_TRANSP, LV_PART_MAIN);
  lv_obj_set_style_text_color(tab, lv_color_hex(active ? kColorAccent : kColorMuted), LV_PART_MAIN);
}

void showPage(Page page) {
  activePage = page;
  if (page == Page::Nodes) {
    refreshNodeTable();
  } else if (page == Page::Info) {
    refreshInfoTable();
  }
  lv_obj_t *const views[] = {messageList, nodeTable, infoTable};
  lv_obj_t *const tabs[] = {messagesTab, nodesTab, infoTab};
  for (uint8_t index = 0; index < 3; ++index) {
    const bool active = index == static_cast<uint8_t>(page);
    if (active) {
      lv_obj_clear_flag(views[index], LV_OBJ_FLAG_HIDDEN);
    } else {
      lv_obj_add_flag(views[index], LV_OBJ_FLAG_HIDDEN);
    }
    styleTab(tabs[index], active);
  }
}

void onTabClicked(lv_event_t *event) {
  showPage(static_cast<Page>(reinterpret_cast<intptr_t>(lv_event_get_user_data(event))));
}

lv_obj_t *createTab(lv_obj_t *parent, const char *text, lv_coord_t x, lv_coord_t width, Page page) {
  lv_obj_t *tab = lv_obj_create(parent);
  lv_obj_remove_style_all(tab);
  lv_obj_set_size(tab, width, kTabBarHeight - 6);
  lv_obj_set_style_bg_color(tab, lv_color_hex(0x2A3140), LV_PART_MAIN);
  lv_obj_set_style_radius(tab, 6, LV_PART_MAIN);
  lv_obj_align(tab, LV_ALIGN_LEFT_MID, x, 0);
  lv_obj_clear_flag(tab, LV_OBJ_FLAG_SCROLLABLE);
  lv_obj_add_event_cb(tab, onTabClicked, LV_EVENT_CLICKED, reinterpret_cast<void *>(static_cast<intptr_t>(page)));

  lv_obj_t *label = lv_label_create(tab);
  lv_label_set_text(label, text);
  lv_obj_center(label);
  return tab;
}

// ---- Screensaver: Swiss railway style clock with stop-to-go second hand ----

lv_obj_t *screensaverScreen = nullptr;
lv_obj_t *clockFace = nullptr;
lv_timer_t *clockFrameTimer = nullptr;
bool screensaverActive = false;
uint32_t screensaverWokenAt = 0;
float secondAngle = 0;  // degrees clockwise from 12
float minuteAngle = 0;
float hourAngle = 0;

void setBacklight(uint8_t level) {
  ledcWrite(TFT_BL, level);
}

// Point at `radius` from the clock centre in direction `angle` (degrees, clockwise from 12).
lv_point_t clockPoint(const lv_area_t &face, float radius, float angle) {
  const float radians = angle * static_cast<float>(M_PI) / 180.0f;
  const lv_coord_t centerX = (face.x1 + face.x2) / 2;
  const lv_coord_t centerY = (face.y1 + face.y2) / 2;
  return {static_cast<lv_coord_t>(lroundf(centerX + radius * sinf(radians))),
          static_cast<lv_coord_t>(lroundf(centerY - radius * cosf(radians)))};
}

// A bar along the radius from `inner` to `outer` (negative = behind the centre),
// tapering from `innerWidth` to `outerWidth`.
void drawRadialBar(lv_draw_ctx_t *drawCtx, const lv_area_t &face, float angle, float inner, float outer,
                   float innerWidth, float outerWidth, uint32_t color) {
  const float radians = angle * static_cast<float>(M_PI) / 180.0f;
  const float centerX = (face.x1 + face.x2) / 2.0f;
  const float centerY = (face.y1 + face.y2) / 2.0f;
  const float dirX = sinf(radians);
  const float dirY = -cosf(radians);
  const float sideX = cosf(radians);
  const float sideY = sinf(radians);
  const float corners[4][2] = {{inner, -innerWidth / 2}, {outer, -outerWidth / 2}, {outer, outerWidth / 2},
                               {inner, innerWidth / 2}};
  lv_point_t points[4];
  for (uint8_t index = 0; index < 4; ++index) {
    points[index].x = static_cast<lv_coord_t>(
        lroundf(centerX + dirX * corners[index][0] + sideX * corners[index][1]));
    points[index].y = static_cast<lv_coord_t>(
        lroundf(centerY + dirY * corners[index][0] + sideY * corners[index][1]));
  }
  lv_draw_rect_dsc_t dsc;
  lv_draw_rect_dsc_init(&dsc);
  dsc.bg_color = lv_color_hex(color);
  lv_draw_polygon(drawCtx, &dsc, points, 4);
}

void drawRing(lv_draw_ctx_t *drawCtx, lv_point_t center, lv_coord_t radius, lv_coord_t width, uint32_t color) {
  lv_draw_rect_dsc_t dsc;
  lv_draw_rect_dsc_init(&dsc);
  dsc.bg_opa = LV_OPA_TRANSP;
  dsc.border_color = lv_color_hex(color);
  dsc.border_width = width;
  dsc.radius = LV_RADIUS_CIRCLE;
  const lv_area_t area = {static_cast<lv_coord_t>(center.x - radius), static_cast<lv_coord_t>(center.y - radius),
                          static_cast<lv_coord_t>(center.x + radius), static_cast<lv_coord_t>(center.y + radius)};
  lv_draw_rect(drawCtx, &dsc, &area);
}

void drawDisc(lv_draw_ctx_t *drawCtx, lv_point_t center, lv_coord_t radius, uint32_t color) {
  lv_draw_rect_dsc_t dsc;
  lv_draw_rect_dsc_init(&dsc);
  dsc.bg_color = lv_color_hex(color);
  dsc.radius = LV_RADIUS_CIRCLE;
  const lv_area_t area = {static_cast<lv_coord_t>(center.x - radius), static_cast<lv_coord_t>(center.y - radius),
                          static_cast<lv_coord_t>(center.x + radius), static_cast<lv_coord_t>(center.y + radius)};
  lv_draw_rect(drawCtx, &dsc, &area);
}

// Dark face in the MeshWatch colours; proportions relative to the face radius.
void drawClockFace(lv_event_t *event) {
  lv_draw_ctx_t *drawCtx = lv_event_get_draw_ctx(event);
  lv_area_t face;
  lv_obj_get_coords(clockFace, &face);
  const float r = kClockRadius;

  lv_draw_rect_dsc_t faceDsc;
  lv_draw_rect_dsc_init(&faceDsc);
  faceDsc.bg_color = lv_color_hex(kClockFace);
  faceDsc.radius = LV_RADIUS_CIRCLE;
  faceDsc.border_color = lv_color_hex(kClockRim);
  faceDsc.border_width = 2;
  lv_draw_rect(drawCtx, &faceDsc, &face);

  for (uint8_t mark = 0; mark < 60; ++mark) {
    if (mark % 5 == 0) {
      drawRadialBar(drawCtx, face, mark * 6.0f, r * 0.70f, r * 0.95f, r * 0.075f, r * 0.075f, kClockInk);
    } else {
      drawDisc(drawCtx, clockPoint(face, r * 0.915f, mark * 6.0f), static_cast<lv_coord_t>(r * 0.022f) + 1,
               kClockInk);
    }
  }

  if (unreadCount > 0) {
    char text[24];
    snprintf(text, sizeof(text), "%u new message%s", unreadCount, unreadCount == 1 ? "" : "s");
    lv_draw_label_dsc_t labelDsc;
    lv_draw_label_dsc_init(&labelDsc);
    labelDsc.font = &lv_font_montserrat_14;
    labelDsc.color = lv_color_hex(kClockSecond);
    labelDsc.align = LV_TEXT_ALIGN_CENTER;
    const lv_coord_t textY = (face.y1 + face.y2) / 2 + static_cast<lv_coord_t>(r * 0.36f);
    const lv_area_t textArea = {face.x1, static_cast<lv_coord_t>(textY - 8), face.x2,
                                static_cast<lv_coord_t>(textY + 10)};
    lv_draw_label(drawCtx, &labelDsc, &textArea, text, nullptr);
  }

  drawRadialBar(drawCtx, face, hourAngle, -r * 0.20f, r * 0.64f, r * 0.115f, r * 0.095f, kClockInk);
  drawRadialBar(drawCtx, face, minuteAngle, -r * 0.20f, r * 0.92f, r * 0.090f, r * 0.068f, kClockInk);
  drawRadialBar(drawCtx, face, secondAngle, -r * 0.30f, r * 0.53f, r * 0.024f, r * 0.024f, kClockSecond);
  drawRing(drawCtx, clockPoint(face, r * 0.62f, secondAngle), static_cast<lv_coord_t>(r * 0.09f),
           static_cast<lv_coord_t>(r * 0.03f), kClockSecond);
  drawDisc(drawCtx, clockPoint(face, 0, 0), static_cast<lv_coord_t>(r * 0.04f), kClockSecond);
}

// Screen area covered by the second hand at `angle`, including tail and disc.
lv_area_t secondHandArea(const lv_area_t &face, float angle) {
  const float r = kClockRadius;
  const lv_point_t tail = clockPoint(face, -r * 0.30f, angle);
  const lv_point_t disc = clockPoint(face, r * 0.62f, angle);
  const lv_coord_t margin = static_cast<lv_coord_t>(r * 0.10f) + 3;
  return {static_cast<lv_coord_t>(min(tail.x, disc.x) - margin), static_cast<lv_coord_t>(min(tail.y, disc.y) - margin),
          static_cast<lv_coord_t>(max(tail.x, disc.x) + margin), static_cast<lv_coord_t>(max(tail.y, disc.y) + margin)};
}

// Stop-to-go: the second hand sweeps the dial in 58.5 s, waits at 12, and the minute
// hand jumps when the new minute starts.
void animateClock(lv_timer_t *timer) {
  (void)timer;
  timeval now{};
  gettimeofday(&now, nullptr);
  float newSecond = 0;
  float newMinute = 0;
  float newHour = 0;
  if (now.tv_sec >= kValidEpoch) {
    struct tm local {};
    const time_t seconds = now.tv_sec;
    localtime_r(&seconds, &local);
    const float elapsed = local.tm_sec + now.tv_usec / 1e6f;
    newSecond = elapsed >= 58.5f ? 0.0f : elapsed / 58.5f * 360.0f;
    newMinute = local.tm_min * 6.0f;
    newHour = (local.tm_hour % 12) * 30.0f + local.tm_min * 0.5f;
  }

  lv_area_t face;
  lv_obj_get_coords(clockFace, &face);
  if (newMinute != minuteAngle || newHour != hourAngle) {
    minuteAngle = newMinute;
    hourAngle = newHour;
    secondAngle = newSecond;
    lv_obj_invalidate(clockFace);
  } else if (newSecond != secondAngle) {
    const lv_area_t before = secondHandArea(face, secondAngle);
    const lv_area_t after = secondHandArea(face, newSecond);
    const lv_area_t dirty = {min(before.x1, after.x1), min(before.y1, after.y1), max(before.x2, after.x2),
                             max(before.y2, after.y2)};
    secondAngle = newSecond;
    lv_obj_invalidate_area(clockFace, &dirty);
  }

  if (screensaverWokenAt != 0 && millis() - screensaverWokenAt >= kScreensaverWakeMs) {
    screensaverWokenAt = 0;
    setBacklight(kBacklightDimmed);
  }
}

// The unread count is printed on the dial, so redraw the face when it changes.
void refreshScreensaverBadge() {
  if (clockFace != nullptr) {
    lv_obj_invalidate(clockFace);
  }
}

void onScreensaverMessage(bool unread) {
  if (unread && screensaverActive) {
    setBacklight(kBacklightFull);
    screensaverWokenAt = millis();
  }
}

void startScreensaver() {
  screensaverActive = true;
  screensaverWokenAt = 0;
  refreshScreensaverBadge();
  animateClock(nullptr);
  lv_obj_invalidate(clockFace);
  lv_scr_load(screensaverScreen);
  lv_timer_resume(clockFrameTimer);
  setBacklight(kBacklightDimmed);
}

void stopScreensaver(lv_event_t *event) {
  (void)event;
  if (!screensaverActive) {
    return;
  }
  screensaverActive = false;
  lv_timer_pause(clockFrameTimer);
  setBacklight(kBacklightFull);
  lv_scr_load(monitorScreen);
  if (unreadCount > 0) {
    showPage(Page::Messages);
  }
}

void createScreensaverScreen() {
  screensaverScreen = lv_obj_create(nullptr);
  lv_obj_set_style_bg_color(screensaverScreen, lv_color_black(), LV_PART_MAIN);
  lv_obj_clear_flag(screensaverScreen, LV_OBJ_FLAG_SCROLLABLE);
  lv_obj_add_event_cb(screensaverScreen, stopScreensaver, LV_EVENT_CLICKED, nullptr);

  clockFace = lv_obj_create(screensaverScreen);
  lv_obj_remove_style_all(clockFace);
  lv_obj_set_size(clockFace, kClockRadius * 2 + 1, kClockRadius * 2 + 1);
  lv_obj_center(clockFace);
  lv_obj_clear_flag(clockFace, LV_OBJ_FLAG_CLICKABLE | LV_OBJ_FLAG_SCROLLABLE);
  lv_obj_add_event_cb(clockFace, drawClockFace, LV_EVENT_DRAW_MAIN, nullptr);

  clockFrameTimer = lv_timer_create(animateClock, kClockFrameMs, nullptr);
  lv_timer_pause(clockFrameTimer);
}

void updateClock(lv_timer_t *timer) {
  (void)timer;
  if (!screensaverActive && lv_scr_act() == monitorScreen && linkState != LinkState::Setup &&
      lv_disp_get_inactive_time(nullptr) >= kScreensaverIdleMs) {
    startScreensaver();
  }
  char clock[8];
  formatClock(time(nullptr), clock, sizeof(clock));
  lv_label_set_text(clockLabel, clock);
  refreshStatus();
  if (activePage == Page::Nodes &&
      (nodeTableDirty || millis() - lastNodeTableRefresh >= kNodeTableRefreshMs)) {
    refreshNodeTable();
  } else if (activePage == Page::Info) {
    refreshInfoTable();
  }
}

void createSplashScreen() {
  lv_obj_t *screen = lv_obj_create(nullptr);
  lv_obj_set_style_bg_color(screen, lv_color_black(), LV_PART_MAIN);
  lv_obj_clear_flag(screen, LV_OBJ_FLAG_SCROLLABLE);

  lv_obj_t *image = lv_img_create(screen);
  lv_img_set_src(image, &splash_image);
  lv_obj_set_pos(image, 0, 0);

  splashStatusLabel = lv_label_create(screen);
  lv_obj_set_style_text_font(splashStatusLabel, &lv_font_montserrat_12, LV_PART_MAIN);
  lv_obj_set_style_text_color(splashStatusLabel, lv_color_hex(kColorMuted), LV_PART_MAIN);
  lv_label_set_text(splashStatusLabel, "Starting...");
  lv_obj_align(splashStatusLabel, LV_ALIGN_BOTTOM_MID, 0, -6);

  lv_scr_load(screen);
  lv_refr_now(nullptr);
}

// Fades from the splash to the monitor screen; the splash is deleted afterwards.
void finishSplash() {
  splashStatusLabel = nullptr;
  lv_scr_load_anim(monitorScreen, LV_SCR_LOAD_ANIM_FADE_ON, 400, 1200, true);
}

void createMonitorScreen() {
  monitorScreen = lv_obj_create(nullptr);
  lv_obj_t *screen = monitorScreen;
  lv_obj_set_style_bg_color(screen, lv_color_hex(kColorBackground), LV_PART_MAIN);
  lv_obj_set_style_text_font(screen, &lv_font_montserrat_14, LV_PART_MAIN);
  lv_obj_clear_flag(screen, LV_OBJ_FLAG_SCROLLABLE);

  lv_style_init(&cardStyle);
  lv_style_set_bg_color(&cardStyle, lv_color_hex(kColorPanel));
  lv_style_set_bg_opa(&cardStyle, LV_OPA_COVER);
  lv_style_set_radius(&cardStyle, 6);
  lv_style_set_pad_all(&cardStyle, 6);

  lv_style_init(&unreadStyle);
  lv_style_set_border_color(&unreadStyle, lv_color_hex(kColorGood));
  lv_style_set_border_width(&unreadStyle, 3);
  lv_style_set_border_side(&unreadStyle, LV_BORDER_SIDE_LEFT);
  lv_style_set_border_opa(&unreadStyle, LV_OPA_COVER);

  // Header: title, unread badge, link status dot, clock.
  lv_obj_t *header = lv_obj_create(screen);
  lv_obj_remove_style_all(header);
  lv_obj_set_size(header, screenWidth, kHeaderHeight);
  lv_obj_set_style_bg_color(header, lv_color_hex(kColorPanel), LV_PART_MAIN);
  lv_obj_set_style_bg_opa(header, LV_OPA_COVER, LV_PART_MAIN);
  lv_obj_clear_flag(header, LV_OBJ_FLAG_SCROLLABLE);

  lv_obj_t *titleLabel = lv_label_create(header);
  lv_label_set_text(titleLabel, "MeshWatch");
  lv_obj_set_style_text_color(titleLabel, lv_color_hex(kColorAccent), LV_PART_MAIN);
  lv_obj_align(titleLabel, LV_ALIGN_LEFT_MID, 8, 0);

  newBadge = lv_label_create(header);
  lv_obj_set_style_bg_color(newBadge, lv_color_hex(kColorGood), LV_PART_MAIN);
  lv_obj_set_style_bg_opa(newBadge, LV_OPA_COVER, LV_PART_MAIN);
  lv_obj_set_style_text_color(newBadge, lv_color_hex(0x06250F), LV_PART_MAIN);
  lv_obj_set_style_text_font(newBadge, &lv_font_montserrat_12, LV_PART_MAIN);
  lv_obj_set_style_radius(newBadge, 8, LV_PART_MAIN);
  lv_obj_set_style_pad_hor(newBadge, 7, LV_PART_MAIN);
  lv_obj_set_style_pad_ver(newBadge, 2, LV_PART_MAIN);
  lv_obj_align(newBadge, LV_ALIGN_CENTER, 30, 0);
  lv_obj_add_flag(newBadge, LV_OBJ_FLAG_HIDDEN);

  clockLabel = lv_label_create(header);
  lv_label_set_text(clockLabel, "--:--");
  lv_obj_set_style_text_color(clockLabel, lv_color_white(), LV_PART_MAIN);
  lv_obj_align(clockLabel, LV_ALIGN_RIGHT_MID, -8, 0);

  statusDot = lv_obj_create(header);
  lv_obj_remove_style_all(statusDot);
  lv_obj_set_size(statusDot, 9, 9);
  lv_obj_set_style_radius(statusDot, LV_RADIUS_CIRCLE, LV_PART_MAIN);
  lv_obj_set_style_bg_opa(statusDot, LV_OPA_COVER, LV_PART_MAIN);
  lv_obj_align(statusDot, LV_ALIGN_RIGHT_MID, -56, 0);

  // Scrollable message list, newest on top. Touching it marks everything read.
  messageList = lv_obj_create(screen);
  lv_obj_remove_style_all(messageList);
  lv_obj_set_size(messageList, screenWidth, screenHeight - kHeaderHeight - kTabBarHeight);
  lv_obj_set_pos(messageList, 0, kHeaderHeight);
  lv_obj_set_flex_flow(messageList, LV_FLEX_FLOW_COLUMN);
  lv_obj_set_style_pad_all(messageList, 4, LV_PART_MAIN);
  lv_obj_set_style_pad_row(messageList, 4, LV_PART_MAIN);
  lv_obj_set_scroll_dir(messageList, LV_DIR_VER);
  lv_obj_set_scrollbar_mode(messageList, LV_SCROLLBAR_MODE_ACTIVE);
  lv_obj_set_style_bg_color(messageList, lv_color_hex(kColorMuted), LV_PART_SCROLLBAR);
  lv_obj_set_style_bg_opa(messageList, LV_OPA_70, LV_PART_SCROLLBAR);
  lv_obj_set_style_width(messageList, 3, LV_PART_SCROLLBAR);
  lv_obj_add_event_cb(messageList, clearUnread, LV_EVENT_PRESSED, nullptr);

  emptyLabel = lv_label_create(messageList);
  lv_obj_set_width(emptyLabel, lv_pct(100));
  lv_label_set_long_mode(emptyLabel, LV_LABEL_LONG_WRAP);
  lv_obj_set_style_text_align(emptyLabel, LV_TEXT_ALIGN_CENTER, LV_PART_MAIN);
  lv_obj_set_style_text_color(emptyLabel, lv_color_hex(kColorMuted), LV_PART_MAIN);
  lv_obj_set_style_pad_top(emptyLabel, 50, LV_PART_MAIN);
  lv_label_set_text(emptyLabel, "No messages yet\n\nText messages heard by your node will appear here.");

  // Node table: name, last heard, hops or SNR, battery.
  nodeTable = lv_table_create(screen);
  lv_obj_set_size(nodeTable, screenWidth, screenHeight - kHeaderHeight - kTabBarHeight);
  lv_obj_set_pos(nodeTable, 0, kHeaderHeight);
  lv_table_set_col_cnt(nodeTable, kNodeColumns);
  lv_table_set_col_width(nodeTable, 0, 152);
  lv_table_set_col_width(nodeTable, 1, 44);
  lv_table_set_col_width(nodeTable, 2, 70);
  lv_table_set_col_width(nodeTable, 3, 46);
  lv_obj_set_style_bg_color(nodeTable, lv_color_hex(kColorBackground), LV_PART_MAIN);
  lv_obj_set_style_border_width(nodeTable, 0, LV_PART_MAIN);
  lv_obj_set_style_radius(nodeTable, 0, LV_PART_MAIN);
  lv_obj_set_style_pad_all(nodeTable, 0, LV_PART_MAIN);
  lv_obj_set_style_pad_left(nodeTable, 4, LV_PART_MAIN);
  lv_obj_set_style_bg_opa(nodeTable, LV_OPA_TRANSP, LV_PART_ITEMS);
  lv_obj_set_style_bg_opa(nodeTable, LV_OPA_TRANSP, static_cast<lv_style_selector_t>(LV_PART_ITEMS) | LV_STATE_PRESSED);
  lv_obj_set_style_border_width(nodeTable, 1, LV_PART_ITEMS);
  lv_obj_set_style_border_side(nodeTable, LV_BORDER_SIDE_BOTTOM, LV_PART_ITEMS);
  lv_obj_set_style_border_color(nodeTable, lv_color_hex(kColorPanel), LV_PART_ITEMS);
  lv_obj_set_style_pad_top(nodeTable, 4, LV_PART_ITEMS);
  lv_obj_set_style_pad_bottom(nodeTable, 3, LV_PART_ITEMS);
  lv_obj_set_style_pad_hor(nodeTable, 4, LV_PART_ITEMS);
  lv_obj_set_style_text_color(nodeTable, lv_color_white(), LV_PART_ITEMS);
  lv_obj_set_style_text_font(nodeTable, &lv_font_montserrat_14, LV_PART_ITEMS);
  lv_obj_set_style_bg_color(nodeTable, lv_color_hex(kColorMuted), LV_PART_SCROLLBAR);
  lv_obj_set_style_width(nodeTable, 3, LV_PART_SCROLLBAR);
  lv_obj_add_event_cb(nodeTable, styleNodeCell, LV_EVENT_DRAW_PART_BEGIN, nullptr);
  lv_obj_add_flag(nodeTable, LV_OBJ_FLAG_HIDDEN);

  // Info table: label / value rows in three sections.
  infoTable = lv_table_create(screen);
  lv_obj_set_size(infoTable, screenWidth, screenHeight - kHeaderHeight - kTabBarHeight);
  lv_obj_set_pos(infoTable, 0, kHeaderHeight);
  lv_table_set_col_cnt(infoTable, 2);
  lv_table_set_col_width(infoTable, 0, 104);
  lv_table_set_col_width(infoTable, 1, 208);
  lv_obj_set_style_bg_color(infoTable, lv_color_hex(kColorBackground), LV_PART_MAIN);
  lv_obj_set_style_border_width(infoTable, 0, LV_PART_MAIN);
  lv_obj_set_style_radius(infoTable, 0, LV_PART_MAIN);
  lv_obj_set_style_pad_all(infoTable, 0, LV_PART_MAIN);
  lv_obj_set_style_pad_left(infoTable, 4, LV_PART_MAIN);
  lv_obj_set_style_bg_opa(infoTable, LV_OPA_TRANSP, LV_PART_ITEMS);
  lv_obj_set_style_bg_opa(infoTable, LV_OPA_TRANSP, static_cast<lv_style_selector_t>(LV_PART_ITEMS) | LV_STATE_PRESSED);
  lv_obj_set_style_border_width(infoTable, 1, LV_PART_ITEMS);
  lv_obj_set_style_border_side(infoTable, LV_BORDER_SIDE_BOTTOM, LV_PART_ITEMS);
  lv_obj_set_style_border_color(infoTable, lv_color_hex(kColorPanel), LV_PART_ITEMS);
  lv_obj_set_style_pad_top(infoTable, 4, LV_PART_ITEMS);
  lv_obj_set_style_pad_bottom(infoTable, 3, LV_PART_ITEMS);
  lv_obj_set_style_pad_hor(infoTable, 4, LV_PART_ITEMS);
  lv_obj_set_style_text_font(infoTable, &lv_font_montserrat_12, LV_PART_ITEMS);
  lv_obj_set_style_bg_color(infoTable, lv_color_hex(kColorMuted), LV_PART_SCROLLBAR);
  lv_obj_set_style_width(infoTable, 3, LV_PART_SCROLLBAR);
  lv_obj_add_event_cb(infoTable, styleInfoCell, LV_EVENT_DRAW_PART_BEGIN, nullptr);
  lv_obj_add_flag(infoTable, LV_OBJ_FLAG_HIDDEN);

  // Tab bar: page switch on the left, link state on the right.
  lv_obj_t *tabBar = lv_obj_create(screen);
  lv_obj_remove_style_all(tabBar);
  lv_obj_set_size(tabBar, screenWidth, kTabBarHeight);
  lv_obj_align(tabBar, LV_ALIGN_BOTTOM_LEFT, 0, 0);
  lv_obj_set_style_bg_color(tabBar, lv_color_hex(kColorPanel), LV_PART_MAIN);
  lv_obj_set_style_bg_opa(tabBar, LV_OPA_COVER, LV_PART_MAIN);
  lv_obj_clear_flag(tabBar, LV_OBJ_FLAG_SCROLLABLE);

  messagesTab = createTab(tabBar, "Messages", 4, 84, Page::Messages);
  nodesTab = createTab(tabBar, "Nodes", 92, 72, Page::Nodes);
  nodesTabLabel = lv_obj_get_child(nodesTab, 0);
  infoTab = createTab(tabBar, "Info", 168, 52, Page::Info);

  footerLabel = lv_label_create(tabBar);
  lv_label_set_long_mode(footerLabel, LV_LABEL_LONG_DOT);
  lv_obj_set_size(footerLabel, 88, 15);
  lv_obj_set_style_text_align(footerLabel, LV_TEXT_ALIGN_RIGHT, LV_PART_MAIN);
  lv_obj_set_style_text_font(footerLabel, &lv_font_montserrat_12, LV_PART_MAIN);
  lv_obj_set_style_text_color(footerLabel, lv_color_hex(kColorMuted), LV_PART_MAIN);
  lv_obj_align(footerLabel, LV_ALIGN_RIGHT_MID, -6, 0);

  showPage(Page::Messages);
  refreshStatus();
  lv_timer_create(updateClock, 1000, nullptr);
}
}  // namespace

void setup() {
  Serial.begin(115200);
  Serial.printf("MeshWatch %s\n", MESHWATCH_VERSION);

  ledcAttach(TFT_BL, 5000, 8);
  ledcWrite(TFT_BL, kBacklightFull);
  pinMode(touchCs, OUTPUT);
  digitalWrite(touchCs, HIGH);
  pinMode(touchIrq, INPUT);

  tft.begin();
  tft.setRotation(displayRotation);
  touchSpi.begin(touchClk, touchMiso, touchMosi, touchCs);

  lv_init();
  lv_disp_draw_buf_init(&drawBuffer, buffer1, buffer2, screenWidth * drawBufferLines);

  static lv_disp_drv_t displayDriver;
  lv_disp_drv_init(&displayDriver);
  displayDriver.hor_res = screenWidth;
  displayDriver.ver_res = screenHeight;
  displayDriver.flush_cb = flushDisplay;
  displayDriver.draw_buf = &drawBuffer;
  lv_disp_drv_register(&displayDriver);

  static lv_indev_drv_t touchDriver;
  lv_indev_drv_init(&touchDriver);
  touchDriver.type = LV_INDEV_TYPE_POINTER;
  touchDriver.read_cb = readTouchForLvgl;
  lv_indev_drv_register(&touchDriver);

  createMonitorScreen();
  createScreensaverScreen();
  createSplashScreen();

  hasRadioAddress = !kForceRadioDiscovery && loadRadioAddress();
  initMessageStore();
  if (!connectToStoredWifi()) {
    restoreMessages();
    startCaptivePortal();
  } else {
    // The 24 h history window needs the real time, which NTP delivers shortly after WiFi.
    setSplashStatus("Syncing time...");
    struct tm now {};
    getLocalTime(&now, kTimeSyncWaitMs);
    setSplashStatus("Loading message history...");
    restoreMessages();
    hasRadioConnectAttempted = true;
    lastRadioConnectAttempt = millis();
    startRadioApi();
  }
  finishSplash();
}

void loop() {
  if (WiFi.status() != WL_CONNECTED) {
    dnsServer.processNextRequest();
    webServer.handleClient();
  } else {
    serviceRadioApi();
  }

  lv_timer_handler();
  delay(5);
}
